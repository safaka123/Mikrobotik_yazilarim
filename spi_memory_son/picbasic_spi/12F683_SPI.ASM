
; PICBASIC PRO(TM) Compiler 3.0.4.1, (c) 1998, 2011 microEngineering Labs, Inc. All Rights Reserved. 
MPASMWIN_USED			EQU	1

#define	PBP_PATH	C:\PBP3\




        NOLIST
    ifdef PM_USED
        LIST
        include 'M12F683.INC'	; PM header
        XALL
        NOLIST
    else
        LIST
        LIST p = 12F683, r = dec, w = -302
        INCLUDE "P12F683.INC"	; MPASM  Header
        NOLIST
    endif
        LIST


PBP_HARDWAREDEF  macro
  endm


 __config _FCMEN_OFF & _IESO_OFF & _CP_OFF & _CPD_OFF & _BOD_OFF & _MCLRE_OFF & _WDT_OFF & _PWRTE_ON & _INTRC_OSC_NOCLKOUT



; Define statements.
; C:\PBP3\DEVICES\PIC12F683.PBPINC	00138	DEFINE	CCP1_REG GPIO
#define		CCP1_REG		 GPIO
; C:\PBP3\DEVICES\PIC12F683.PBPINC	00139	DEFINE	CCP1_BIT 2
#define		CCP1_BIT		 2
; D:\MIKROBOTIK_DENEMELER\SPI_MEMORY_SON\PICBASIC_SPI\12F683_SPI.PBP	00010	DEFINE OSC 8
#define		OSC		 8

RAM_START       		EQU	00020h
RAM_END         		EQU	000BFh
RAM_BANKS       		EQU	00002h
BANK0_START     		EQU	00020h
BANK0_END       		EQU	0007Fh
BANK1_START     		EQU	000A0h
BANK1_END       		EQU	000BFh
EEPROM_START    		EQU	02100h
EEPROM_END      		EQU	021FFh

; C:\PBP3\PBPPIC14.RAM     	00012	A00020	R0      VAR     WORD BANK0 SYSTEM       ' System Register
R0              		EQU	RAM_START + 000h
; C:\PBP3\PBPPIC14.RAM     	00013	A00022	R1      VAR     WORD BANK0 SYSTEM       ' System Register
R1              		EQU	RAM_START + 002h
; C:\PBP3\PBPPIC14.RAM     	00014	A00024	R2      VAR     WORD BANK0 SYSTEM       ' System Register
R2              		EQU	RAM_START + 004h
; C:\PBP3\PBPPIC14.RAM     	00015	A00026	R3      VAR     WORD BANK0 SYSTEM       ' System Register
R3              		EQU	RAM_START + 006h
; C:\PBP3\PBPPIC14.RAM     	00016	A00028	R4      VAR     WORD BANK0 SYSTEM       ' System Register
R4              		EQU	RAM_START + 008h
; C:\PBP3\PBPPIC14.RAM     	00017	A0002A	R5      VAR     WORD BANK0 SYSTEM       ' System Register
R5              		EQU	RAM_START + 00Ah
; C:\PBP3\PBPPIC14.RAM     	00018	A0002C	R6      VAR     WORD BANK0 SYSTEM       ' System Register
R6              		EQU	RAM_START + 00Ch
; C:\PBP3\PBPPIC14.RAM     	00019	A0002E	R7      VAR     WORD BANK0 SYSTEM       ' System Register
R7              		EQU	RAM_START + 00Eh
; C:\PBP3\PBPPIC14.RAM     	00020	A00030	R8      VAR     WORD BANK0 SYSTEM       ' System Register
R8              		EQU	RAM_START + 010h
; C:\PBP3\PBPPIC14.RAM     	00026	A00032	FLAGS   VAR     BYTE BANK0 SYSTEM       ' Static flags
FLAGS           		EQU	RAM_START + 012h
; C:\PBP3\PBPPIC14.RAM     	00025	A00033	GOP     VAR     BYTE BANK0 SYSTEM       ' Gen Op Parameter
GOP             		EQU	RAM_START + 013h
; C:\PBP3\PBPPIC14.RAM     	00022	A00034	RM1     VAR     BYTE BANK0 SYSTEM       ' Pin 1 Mask
RM1             		EQU	RAM_START + 014h
; C:\PBP3\PBPPIC14.RAM     	00024	A00035	RM2     VAR     BYTE BANK0 SYSTEM       ' Pin 2 Mask
RM2             		EQU	RAM_START + 015h
; C:\PBP3\PBPPIC14.RAM     	00021	A00036	RR1     VAR     BYTE BANK0 SYSTEM       ' Pin 1 Register
RR1             		EQU	RAM_START + 016h
; C:\PBP3\PBPPIC14.RAM     	00023	A00037	RR2     VAR     BYTE BANK0 SYSTEM       ' Pin 2 Register
RR2             		EQU	RAM_START + 017h
; D:\MIKROBOTIK_DENEMELER\SPI_MEMORY_SON\PICBASIC_SPI\12F683_SPI.PBP	00027	A00038	say var word       ;65536 ya kadar sayýlabilir.    Binary olarak 16 bit. 1111 1111 1111 1111
_say             		EQU	RAM_START + 018h
; D:\MIKROBOTIK_DENEMELER\SPI_MEMORY_SON\PICBASIC_SPI\12F683_SPI.PBP	00001	A0003A	'****************************************************************
T1              		EQU	RAM_START + 01Ah
; D:\MIKROBOTIK_DENEMELER\SPI_MEMORY_SON\PICBASIC_SPI\12F683_SPI.PBP	00040	A0003C	addr1   var byte
_addr1           		EQU	RAM_START + 01Ch
; D:\MIKROBOTIK_DENEMELER\SPI_MEMORY_SON\PICBASIC_SPI\12F683_SPI.PBP	00041	A0003D	addr2   var byte
_addr2           		EQU	RAM_START + 01Dh
; D:\MIKROBOTIK_DENEMELER\SPI_MEMORY_SON\PICBASIC_SPI\12F683_SPI.PBP	00042	A0003E	addr3   var byte
_addr3           		EQU	RAM_START + 01Eh
; D:\MIKROBOTIK_DENEMELER\SPI_MEMORY_SON\PICBASIC_SPI\12F683_SPI.PBP	00038	A0003F	oku1    var byte
_oku1            		EQU	RAM_START + 01Fh
; D:\MIKROBOTIK_DENEMELER\SPI_MEMORY_SON\PICBASIC_SPI\12F683_SPI.PBP	00039	A00040	oku2    var byte
_oku2            		EQU	RAM_START + 020h
; D:\MIKROBOTIK_DENEMELER\SPI_MEMORY_SON\PICBASIC_SPI\12F683_SPI.PBP	00036	A00041	say2   var byte
_say2            		EQU	RAM_START + 021h
; D:\MIKROBOTIK_DENEMELER\SPI_MEMORY_SON\PICBASIC_SPI\12F683_SPI.PBP	00035	A00042	temp1   var byte
_temp1           		EQU	RAM_START + 022h
; D:\MIKROBOTIK_DENEMELER\SPI_MEMORY_SON\PICBASIC_SPI\12F683_SPI.PBP	00037	A00043	yaz     var byte
_yaz             		EQU	RAM_START + 023h
; C:\PBP3\DEVICES\PIC12F683.PBPINC	00140	PORTL   VAR     GPIO
_PORTL           		EQU	 GPIO
; C:\PBP3\DEVICES\PIC12F683.PBPINC	00141	PORTH   VAR     GPIO
_PORTH           		EQU	 GPIO
; C:\PBP3\DEVICES\PIC12F683.PBPINC	00142	TRISL   VAR     TRISIO
_TRISL           		EQU	 TRISIO
; C:\PBP3\DEVICES\PIC12F683.PBPINC	00143	TRISH   VAR     TRISIO
_TRISH           		EQU	 TRISIO
#define _SS              	_GPIO??0
#define _SCK             	_GPIO??1
#define _MOSI            	_GPIO??2
#define _MISO            	_GPIO??3
#define _GPIO??0         	 GPIO, 000h
#define _GPIO??1         	 GPIO, 001h
#define _GPIO??2         	 GPIO, 002h
#define _GPIO??3         	 GPIO, 003h
#define _GPIO??5         	 GPIO, 005h
#define _GPIO??4         	 GPIO, 004h

; Constants.
_T2400           		EQU	00000h
_T1200           		EQU	00001h
_T9600           		EQU	00002h
_T300            		EQU	00003h
_N2400           		EQU	00004h
_N1200           		EQU	00005h
_N9600           		EQU	00006h
_N300            		EQU	00007h
_OT2400          		EQU	00008h
_OT1200          		EQU	00009h
_OT9600          		EQU	0000Ah
_OT300           		EQU	0000Bh
_ON2400          		EQU	0000Ch
_ON1200          		EQU	0000Dh
_ON9600          		EQU	0000Eh
_ON300           		EQU	0000Fh
_MSBPRE          		EQU	00000h
_LSBPRE          		EQU	00001h
_MSBPOST         		EQU	00002h
_LSBPOST         		EQU	00003h
_LSBFIRST        		EQU	00000h
_MSBFIRST        		EQU	00001h
_CLS             		EQU	00000h
_HOME            		EQU	00001h
_BELL            		EQU	00007h
_BKSP            		EQU	00008h
_TAB             		EQU	00009h
_CR              		EQU	0000Dh
_UnitOn          		EQU	00012h
_UnitOff         		EQU	0001Ah
_UnitsOff        		EQU	0001Ch
_LightsOn        		EQU	00014h
_LightsOff       		EQU	00010h
_Dim             		EQU	0001Eh
_Bright          		EQU	00016h
	INCLUDE	"12F683_SPI.MAC"
	INCLUDE	"C:\PBP3\PBPPIC14.LIB"


; C:\PBP3\DEVICES\PIC12F683.PBPINC	00036	#HEADER
; C:\PBP3\DEVICES\PIC12F683.PBPINC	00061	#CONFIG
; C:\PBP3\DEVICES\PIC12F683.PBPINC	00130	BANK0   $0020, $007F
; C:\PBP3\DEVICES\PIC12F683.PBPINC	00131	BANK1   $00A0, $00BF
; C:\PBP3\DEVICES\PIC12F683.PBPINC	00133	EEPROM  $2100, $21FF
; C:\PBP3\DEVICES\PIC12F683.PBPINC	00135	    #ERROR "-n option (PBPL) is not supported for this device."
; C:\PBP3\DEVICES\PIC12F683.PBPINC	00136	#ENDIF
; C:\PBP3\DEVICES\PIC12F683.PBPINC	00137	LIBRARY "PBPPIC14"
; C:\PBP3\DEVICES\PIC12F683.PBPINC	00138	DEFINE	CCP1_REG GPIO
; C:\PBP3\DEVICES\PIC12F683.PBPINC	00139	DEFINE	CCP1_BIT 2

; C:\PBP3\DEVICES\PIC12F683.PBPINC	00144	include "PBPPIC14.RAM"
; C:\PBP3\DEVICES\PIC12F683.PBPINC	00148	#HEADER
; D:\MIKROBOTIK_DENEMELER\SPI_MEMORY_SON\PICBASIC_SPI\12F683_SPI.PBP	00010	DEFINE OSC 8

; D:\MIKROBOTIK_DENEMELER\SPI_MEMORY_SON\PICBASIC_SPI\12F683_SPI.PBP	00011	 Include "Modedefs.Bas"
; C:\PBP3\MODEDEFS.BAS     	00014	Symbol T2400  = 0       ' Driven True
; C:\PBP3\MODEDEFS.BAS     	00015	Symbol T1200  = 1       ' Driven True
; C:\PBP3\MODEDEFS.BAS     	00016	Symbol T9600  = 2       ' Driven True
; C:\PBP3\MODEDEFS.BAS     	00017	Symbol T300   = 3       ' Driven True
; C:\PBP3\MODEDEFS.BAS     	00019	Symbol N2400  = 4       ' Driven Inverted
; C:\PBP3\MODEDEFS.BAS     	00020	Symbol N1200  = 5       ' Driven Inverted
; C:\PBP3\MODEDEFS.BAS     	00021	Symbol N9600  = 6       ' Driven Inverted
; C:\PBP3\MODEDEFS.BAS     	00022	Symbol N300   = 7       ' Driven Inverted
; C:\PBP3\MODEDEFS.BAS     	00024	Symbol OT2400 = 8       ' Open True
; C:\PBP3\MODEDEFS.BAS     	00025	Symbol OT1200 = 9       ' Open True
; C:\PBP3\MODEDEFS.BAS     	00026	Symbol OT9600 = 10      ' Open True
; C:\PBP3\MODEDEFS.BAS     	00027	Symbol OT300  = 11      ' Open True
; C:\PBP3\MODEDEFS.BAS     	00029	Symbol ON2400 = 12      ' Open Inverted
; C:\PBP3\MODEDEFS.BAS     	00030	Symbol ON1200 = 13      ' Open Inverted
; C:\PBP3\MODEDEFS.BAS     	00031	Symbol ON9600 = 14      ' Open Inverted
; C:\PBP3\MODEDEFS.BAS     	00032	Symbol ON300  = 15      ' Open Inverted
; C:\PBP3\MODEDEFS.BAS     	00036	Symbol MSBPRE = 0       ' MSB first, sample before clock
; C:\PBP3\MODEDEFS.BAS     	00037	Symbol LSBPRE = 1       ' LSB first, sample before clock
; C:\PBP3\MODEDEFS.BAS     	00038	Symbol MSBPOST = 2      ' MSB first, sample after clock
; C:\PBP3\MODEDEFS.BAS     	00039	Symbol LSBPOST = 3      ' LSB first, sample after clock
; C:\PBP3\MODEDEFS.BAS     	00042	Symbol LSBFIRST = 0     ' LSB first
; C:\PBP3\MODEDEFS.BAS     	00043	Symbol MSBFIRST = 1     ' MSB first
; C:\PBP3\MODEDEFS.BAS     	00047	Symbol CLS = 0
; C:\PBP3\MODEDEFS.BAS     	00048	Symbol HOME = 1
; C:\PBP3\MODEDEFS.BAS     	00049	Symbol BELL = 7
; C:\PBP3\MODEDEFS.BAS     	00050	Symbol BKSP = 8
; C:\PBP3\MODEDEFS.BAS     	00051	Symbol TAB = 9
; C:\PBP3\MODEDEFS.BAS     	00052	Symbol CR = 13
; C:\PBP3\MODEDEFS.BAS     	00056	Symbol UnitOn = %10010
; C:\PBP3\MODEDEFS.BAS     	00057	Symbol UnitOff = %11010
; C:\PBP3\MODEDEFS.BAS     	00058	Symbol UnitsOff = %11100
; C:\PBP3\MODEDEFS.BAS     	00059	Symbol LightsOn = %10100
; C:\PBP3\MODEDEFS.BAS     	00060	Symbol LightsOff = %10000
; C:\PBP3\MODEDEFS.BAS     	00061	Symbol Dim = %11110
; C:\PBP3\MODEDEFS.BAS     	00062	Symbol Bright = %10110
; D:\MIKROBOTIK_DENEMELER\SPI_MEMORY_SON\PICBASIC_SPI\12F683_SPI.PBP	00013	#config

; D:\MIKROBOTIK_DENEMELER\SPI_MEMORY_SON\PICBASIC_SPI\12F683_SPI.PBP	00018	OSCCON=%01110101   ; Ýlk programa dönüþ için osccal deðerini kapat. 
	MOVE?CB	075h, OSCCON

; D:\MIKROBOTIK_DENEMELER\SPI_MEMORY_SON\PICBASIC_SPI\12F683_SPI.PBP	00019	CMCON0 = 7
	MOVE?CB	007h, CMCON0

; D:\MIKROBOTIK_DENEMELER\SPI_MEMORY_SON\PICBASIC_SPI\12F683_SPI.PBP	00020	ADCON0=%00000000
	MOVE?CB	000h, ADCON0

; D:\MIKROBOTIK_DENEMELER\SPI_MEMORY_SON\PICBASIC_SPI\12F683_SPI.PBP	00021	ANSEL=0 ;ADC ler iptal
	MOVE?CB	000h, ANSEL

; D:\MIKROBOTIK_DENEMELER\SPI_MEMORY_SON\PICBASIC_SPI\12F683_SPI.PBP	00022	TRISIO=%00011000
	MOVE?CB	018h, TRISIO

; D:\MIKROBOTIK_DENEMELER\SPI_MEMORY_SON\PICBASIC_SPI\12F683_SPI.PBP	00048	addr1=$00
	MOVE?CB	000h, _addr1

; D:\MIKROBOTIK_DENEMELER\SPI_MEMORY_SON\PICBASIC_SPI\12F683_SPI.PBP	00049	  addr2=$00
	MOVE?CB	000h, _addr2

; D:\MIKROBOTIK_DENEMELER\SPI_MEMORY_SON\PICBASIC_SPI\12F683_SPI.PBP	00050	  addr3=$00
	MOVE?CB	000h, _addr3

; D:\MIKROBOTIK_DENEMELER\SPI_MEMORY_SON\PICBASIC_SPI\12F683_SPI.PBP	00051	  yaz=0
	MOVE?CB	000h, _yaz

; D:\MIKROBOTIK_DENEMELER\SPI_MEMORY_SON\PICBASIC_SPI\12F683_SPI.PBP	00053	 basla:

	LABEL?L	_basla	

; D:\MIKROBOTIK_DENEMELER\SPI_MEMORY_SON\PICBASIC_SPI\12F683_SPI.PBP	00055	  call Dwrite
	CALL?L	_Dwrite

; D:\MIKROBOTIK_DENEMELER\SPI_MEMORY_SON\PICBASIC_SPI\12F683_SPI.PBP	00056	  pause 1000
	PAUSE?C	003E8h

; D:\MIKROBOTIK_DENEMELER\SPI_MEMORY_SON\PICBASIC_SPI\12F683_SPI.PBP	00057	  Call Dread
	CALL?L	_Dread

; D:\MIKROBOTIK_DENEMELER\SPI_MEMORY_SON\PICBASIC_SPI\12F683_SPI.PBP	00058	  Pause 1000
	PAUSE?C	003E8h

; D:\MIKROBOTIK_DENEMELER\SPI_MEMORY_SON\PICBASIC_SPI\12F683_SPI.PBP	00059	  SEROUT2 GPIO.5,84,["YAzilan:   ",HEX2 yaz,"   ",HEX2 yaz+1,"   ","  Okunan:  ",HEX2 oku1,"   ",HEX2 oku2,13,10]
	SEROUT2DPIN?T	_GPIO??5
	SEROUT2MODE?C	054h
	SEROUT2PACE?C	000h
	SEROUT2?C	059h
	SEROUT2?C	041h
	SEROUT2?C	07Ah
	SEROUT2?C	069h
	SEROUT2?C	06Ch
	SEROUT2?C	061h
	SEROUT2?C	06Eh
	SEROUT2?C	03Ah
	SEROUT2?C	020h
	SEROUT2?C	020h
	SEROUT2?C	020h
	SEROUT2COUNT?C	002h
	SEROUT2NUM?B	_yaz
	SEROUT2HEX?	
	SEROUT2?C	020h
	SEROUT2?C	020h
	SEROUT2?C	020h
	SEROUT2COUNT?C	002h
	ADD?BCW	_yaz, 001h, T1
	SEROUT2NUM?W	T1
	SEROUT2HEX?	
	SEROUT2?C	020h
	SEROUT2?C	020h
	SEROUT2?C	020h
	SEROUT2?C	020h
	SEROUT2?C	020h
	SEROUT2?C	04Fh
	SEROUT2?C	06Bh
	SEROUT2?C	075h
	SEROUT2?C	06Eh
	SEROUT2?C	061h
	SEROUT2?C	06Eh
	SEROUT2?C	03Ah
	SEROUT2?C	020h
	SEROUT2?C	020h
	SEROUT2COUNT?C	002h
	SEROUT2NUM?B	_oku1
	SEROUT2HEX?	
	SEROUT2?C	020h
	SEROUT2?C	020h
	SEROUT2?C	020h
	SEROUT2COUNT?C	002h
	SEROUT2NUM?B	_oku2
	SEROUT2HEX?	
	SEROUT2?C	00Dh
	SEROUT2?C	00Ah

; D:\MIKROBOTIK_DENEMELER\SPI_MEMORY_SON\PICBASIC_SPI\12F683_SPI.PBP	00060	  addr3=addr3+2  
	ADD?BCB	_addr3, 002h, _addr3

; D:\MIKROBOTIK_DENEMELER\SPI_MEMORY_SON\PICBASIC_SPI\12F683_SPI.PBP	00061	  yaz=yaz+2 
	ADD?BCB	_yaz, 002h, _yaz

; D:\MIKROBOTIK_DENEMELER\SPI_MEMORY_SON\PICBASIC_SPI\12F683_SPI.PBP	00062	  Pause 1000 
	PAUSE?C	003E8h

; D:\MIKROBOTIK_DENEMELER\SPI_MEMORY_SON\PICBASIC_SPI\12F683_SPI.PBP	00063	   if GPIO.4=0 then 
	CMPNE?TCL	_GPIO??4, 000h, L00001

; D:\MIKROBOTIK_DENEMELER\SPI_MEMORY_SON\PICBASIC_SPI\12F683_SPI.PBP	00064	   SEROUT2 GPIO.5,84,["silme butona basildi",13,10]
	SEROUT2DPIN?T	_GPIO??5
	SEROUT2MODE?C	054h
	SEROUT2PACE?C	000h
	SEROUT2?C	073h
	SEROUT2?C	069h
	SEROUT2?C	06Ch
	SEROUT2?C	06Dh
	SEROUT2?C	065h
	SEROUT2?C	020h
	SEROUT2?C	062h
	SEROUT2?C	075h
	SEROUT2?C	074h
	SEROUT2?C	06Fh
	SEROUT2?C	06Eh
	SEROUT2?C	061h
	SEROUT2?C	020h
	SEROUT2?C	062h
	SEROUT2?C	061h
	SEROUT2?C	073h
	SEROUT2?C	069h
	SEROUT2?C	06Ch
	SEROUT2?C	064h
	SEROUT2?C	069h
	SEROUT2?C	00Dh
	SEROUT2?C	00Ah

; D:\MIKROBOTIK_DENEMELER\SPI_MEMORY_SON\PICBASIC_SPI\12F683_SPI.PBP	00065	   call pageerase
	CALL?L	_pageerase

; D:\MIKROBOTIK_DENEMELER\SPI_MEMORY_SON\PICBASIC_SPI\12F683_SPI.PBP	00066	   endif
	LABEL?L	L00001	

; D:\MIKROBOTIK_DENEMELER\SPI_MEMORY_SON\PICBASIC_SPI\12F683_SPI.PBP	00067	 goto basla
	GOTO?L	_basla

; D:\MIKROBOTIK_DENEMELER\SPI_MEMORY_SON\PICBASIC_SPI\12F683_SPI.PBP	00069	 pageerase:

	LABEL?L	_pageerase	

; D:\MIKROBOTIK_DENEMELER\SPI_MEMORY_SON\PICBASIC_SPI\12F683_SPI.PBP	00070	    Low SS ' haberleþme aç
	LOW?T	_SS

; D:\MIKROBOTIK_DENEMELER\SPI_MEMORY_SON\PICBASIC_SPI\12F683_SPI.PBP	00071	    Shiftout MoSI,SCK,MSBFIRST,[6] ' komut ve veri gönder
	SHIFTDATA?T	_MOSI
	SHIFTCLOCK?T	_SCK
	SHIFTMODE?C	_MSBFIRST
	SHIFTOUT?CC	006h, 008h

; D:\MIKROBOTIK_DENEMELER\SPI_MEMORY_SON\PICBASIC_SPI\12F683_SPI.PBP	00072	    High SS ' haberleþme kapat
	HIGH?T	_SS

; D:\MIKROBOTIK_DENEMELER\SPI_MEMORY_SON\PICBASIC_SPI\12F683_SPI.PBP	00073	    Low SS ' haberleþme aç
	LOW?T	_SS

; D:\MIKROBOTIK_DENEMELER\SPI_MEMORY_SON\PICBASIC_SPI\12F683_SPI.PBP	00074	    pause 10
	PAUSE?C	00Ah

; D:\MIKROBOTIK_DENEMELER\SPI_MEMORY_SON\PICBASIC_SPI\12F683_SPI.PBP	00075	    Shiftout MOSI,SCK,MSBFIRST,[$42,$0,$0,$0]' komut ve veri gonder
	SHIFTDATA?T	_MOSI
	SHIFTCLOCK?T	_SCK
	SHIFTMODE?C	_MSBFIRST
	SHIFTOUT?CC	042h, 008h
	SHIFTOUT?CC	000h, 008h
	SHIFTOUT?CC	000h, 008h
	SHIFTOUT?CC	000h, 008h

; D:\MIKROBOTIK_DENEMELER\SPI_MEMORY_SON\PICBASIC_SPI\12F683_SPI.PBP	00076	    High SS ' Haberleþme kapat
	HIGH?T	_SS

; D:\MIKROBOTIK_DENEMELER\SPI_MEMORY_SON\PICBASIC_SPI\12F683_SPI.PBP	00077	    Pause 3000 ' Allow the eeprom to allocate the byte
	PAUSE?C	00BB8h

; D:\MIKROBOTIK_DENEMELER\SPI_MEMORY_SON\PICBASIC_SPI\12F683_SPI.PBP	00079	 return
	RETURN?	

; D:\MIKROBOTIK_DENEMELER\SPI_MEMORY_SON\PICBASIC_SPI\12F683_SPI.PBP	00081	 Dwrite:

	LABEL?L	_Dwrite	

; D:\MIKROBOTIK_DENEMELER\SPI_MEMORY_SON\PICBASIC_SPI\12F683_SPI.PBP	00082	 Low SS ' haberleþme aç
	LOW?T	_SS

; D:\MIKROBOTIK_DENEMELER\SPI_MEMORY_SON\PICBASIC_SPI\12F683_SPI.PBP	00083	Shiftout MoSI,SCK,MSBFIRST,[6] ' komut ve veri gönder
	SHIFTDATA?T	_MOSI
	SHIFTCLOCK?T	_SCK
	SHIFTMODE?C	_MSBFIRST
	SHIFTOUT?CC	006h, 008h

; D:\MIKROBOTIK_DENEMELER\SPI_MEMORY_SON\PICBASIC_SPI\12F683_SPI.PBP	00084	High SS ' haberleþme kapat
	HIGH?T	_SS

; D:\MIKROBOTIK_DENEMELER\SPI_MEMORY_SON\PICBASIC_SPI\12F683_SPI.PBP	00085	Low SS ' haberleþme aç
	LOW?T	_SS

; D:\MIKROBOTIK_DENEMELER\SPI_MEMORY_SON\PICBASIC_SPI\12F683_SPI.PBP	00086	Shiftout MOSI,SCK,MSBFIRST,[2,Addr1,addr2,addr3,yaz,yaz+1]' komut ve veri gonder
	SHIFTDATA?T	_MOSI
	SHIFTCLOCK?T	_SCK
	SHIFTMODE?C	_MSBFIRST
	SHIFTOUT?CC	002h, 008h
	SHIFTOUT?BC	_addr1, 008h
	SHIFTOUT?BC	_addr2, 008h
	SHIFTOUT?BC	_addr3, 008h
	SHIFTOUT?BC	_yaz, 008h
	ADD?BCW	_yaz, 001h, T1
	SHIFTOUT?WC	T1, 008h

; D:\MIKROBOTIK_DENEMELER\SPI_MEMORY_SON\PICBASIC_SPI\12F683_SPI.PBP	00087	High SS ' Haberleþme kapat
	HIGH?T	_SS

; D:\MIKROBOTIK_DENEMELER\SPI_MEMORY_SON\PICBASIC_SPI\12F683_SPI.PBP	00088	Pause 5 ' Allow the eeprom to allocate the byte
	PAUSE?C	005h

; D:\MIKROBOTIK_DENEMELER\SPI_MEMORY_SON\PICBASIC_SPI\12F683_SPI.PBP	00089	Return
	RETURN?	

; D:\MIKROBOTIK_DENEMELER\SPI_MEMORY_SON\PICBASIC_SPI\12F683_SPI.PBP	00093	 Dread:

	LABEL?L	_Dread	

; D:\MIKROBOTIK_DENEMELER\SPI_MEMORY_SON\PICBASIC_SPI\12F683_SPI.PBP	00095	Eread: Low SS ' haberleþme aç

	LABEL?L	_Eread	

; D:\MIKROBOTIK_DENEMELER\SPI_MEMORY_SON\PICBASIC_SPI\12F683_SPI.PBP	00095	Eread: Low SS ' haberleþme aç
	LOW?T	_SS

; D:\MIKROBOTIK_DENEMELER\SPI_MEMORY_SON\PICBASIC_SPI\12F683_SPI.PBP	00096	Shiftout MOSI,SCK,MSBFIRST,[3,Addr1,addr2,addr3]' veri okuma baþlangýç adresi gönder
	SHIFTDATA?T	_MOSI
	SHIFTCLOCK?T	_SCK
	SHIFTMODE?C	_MSBFIRST
	SHIFTOUT?CC	003h, 008h
	SHIFTOUT?BC	_addr1, 008h
	SHIFTOUT?BC	_addr2, 008h
	SHIFTOUT?BC	_addr3, 008h

; D:\MIKROBOTIK_DENEMELER\SPI_MEMORY_SON\PICBASIC_SPI\12F683_SPI.PBP	00097	Shiftin MISO,SCK,MSBPRE,[oku1,oku2] ' veri okuma
	SHIFTDATA?T	_MISO
	SHIFTCLOCK?T	_SCK
	SHIFTMODE?C	_MSBPRE
	SHIFTIN?BC	_oku1, 008h
	SHIFTIN?BC	_oku2, 008h

; D:\MIKROBOTIK_DENEMELER\SPI_MEMORY_SON\PICBASIC_SPI\12F683_SPI.PBP	00098	High SS ' haberleþme kapat
	HIGH?T	_SS

; D:\MIKROBOTIK_DENEMELER\SPI_MEMORY_SON\PICBASIC_SPI\12F683_SPI.PBP	00099	Return
	RETURN?	

; D:\MIKROBOTIK_DENEMELER\SPI_MEMORY_SON\PICBASIC_SPI\12F683_SPI.PBP	00102	 return
	RETURN?	

; D:\MIKROBOTIK_DENEMELER\SPI_MEMORY_SON\PICBASIC_SPI\12F683_SPI.PBP	00107	end
	END?	

	END
