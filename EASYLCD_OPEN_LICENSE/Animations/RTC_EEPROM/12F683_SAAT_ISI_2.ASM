
; PICBASIC PRO(TM) Compiler 3.0.4.1, (c) 1998, 2011 microEngineering Labs, Inc. All Rights Reserved. 
MPASMWIN_USED			EQU	1

#define	PBP_PATH	C:\PBP3\




        NOLIST
    ifdef PM_USED
        LIST
        include 'M12F683.INC'	; PM header
        XALL
        NOLIST
    else
        LIST
        LIST p = 12F683, r = dec, w = -302
        INCLUDE "P12F683.INC"	; MPASM  Header
        NOLIST
    endif
        LIST


PBP_HARDWAREDEF  macro
  endm


 __config _FCMEN_OFF & _IESO_OFF & _CP_OFF & _CPD_OFF & _BOD_OFF & _MCLRE_OFF & _WDT_OFF & _PWRTE_ON & _INTRC_OSC_NOCLKOUT



; Define statements.
; C:\PBP3\DEVICES\PIC12F683.PBPINC	00138	DEFINE	CCP1_REG GPIO
#define		CCP1_REG		 GPIO
; C:\PBP3\DEVICES\PIC12F683.PBPINC	00139	DEFINE	CCP1_BIT 2
#define		CCP1_BIT		 2
; C:\DOCUMENTS AND SETTINGS\LG_PC\DESKTOP\SPARK_LCD\RTC_EEPROM\12F683_SAAT_ISI_2.PBP	00011	DEFINE OSC 8
#define		OSC		 8

RAM_START       		EQU	00020h
RAM_END         		EQU	000BFh
RAM_BANKS       		EQU	00002h
BANK0_START     		EQU	00020h
BANK0_END       		EQU	0007Fh
BANK1_START     		EQU	000A0h
BANK1_END       		EQU	000BFh
EEPROM_START    		EQU	02100h
EEPROM_END      		EQU	021FFh

; C:\PBP3\PBPPIC14.RAM     	00012	A00020	R0      VAR     WORD BANK0 SYSTEM       ' System Register
R0              		EQU	RAM_START + 000h
; C:\PBP3\PBPPIC14.RAM     	00013	A00022	R1      VAR     WORD BANK0 SYSTEM       ' System Register
R1              		EQU	RAM_START + 002h
; C:\PBP3\PBPPIC14.RAM     	00014	A00024	R2      VAR     WORD BANK0 SYSTEM       ' System Register
R2              		EQU	RAM_START + 004h
; C:\PBP3\PBPPIC14.RAM     	00015	A00026	R3      VAR     WORD BANK0 SYSTEM       ' System Register
R3              		EQU	RAM_START + 006h
; C:\PBP3\PBPPIC14.RAM     	00016	A00028	R4      VAR     WORD BANK0 SYSTEM       ' System Register
R4              		EQU	RAM_START + 008h
; C:\PBP3\PBPPIC14.RAM     	00017	A0002A	R5      VAR     WORD BANK0 SYSTEM       ' System Register
R5              		EQU	RAM_START + 00Ah
; C:\PBP3\PBPPIC14.RAM     	00018	A0002C	R6      VAR     WORD BANK0 SYSTEM       ' System Register
R6              		EQU	RAM_START + 00Ch
; C:\PBP3\PBPPIC14.RAM     	00019	A0002E	R7      VAR     WORD BANK0 SYSTEM       ' System Register
R7              		EQU	RAM_START + 00Eh
; C:\PBP3\PBPPIC14.RAM     	00020	A00030	R8      VAR     WORD BANK0 SYSTEM       ' System Register
R8              		EQU	RAM_START + 010h
; C:\PBP3\PBPPIC14.RAM     	00026	A00032	FLAGS   VAR     BYTE BANK0 SYSTEM       ' Static flags
FLAGS           		EQU	RAM_START + 012h
; C:\PBP3\PBPPIC14.RAM     	00025	A00033	GOP     VAR     BYTE BANK0 SYSTEM       ' Gen Op Parameter
GOP             		EQU	RAM_START + 013h
; C:\PBP3\PBPPIC14.RAM     	00022	A00034	RM1     VAR     BYTE BANK0 SYSTEM       ' Pin 1 Mask
RM1             		EQU	RAM_START + 014h
; C:\PBP3\PBPPIC14.RAM     	00024	A00035	RM2     VAR     BYTE BANK0 SYSTEM       ' Pin 2 Mask
RM2             		EQU	RAM_START + 015h
; C:\PBP3\PBPPIC14.RAM     	00021	A00036	RR1     VAR     BYTE BANK0 SYSTEM       ' Pin 1 Register
RR1             		EQU	RAM_START + 016h
; C:\PBP3\PBPPIC14.RAM     	00023	A00037	RR2     VAR     BYTE BANK0 SYSTEM       ' Pin 2 Register
RR2             		EQU	RAM_START + 017h
; C:\DOCUMENTS AND SETTINGS\LG_PC\DESKTOP\SPARK_LCD\RTC_EEPROM\12F683_SAAT_ISI_2.PBP	00001	A00038	'****************************************************************
T1              		EQU	RAM_START + 018h
; C:\DOCUMENTS AND SETTINGS\LG_PC\DESKTOP\SPARK_LCD\RTC_EEPROM\12F683_SAAT_ISI_2.PBP	00001	A0003A	'****************************************************************
T2              		EQU	RAM_START + 01Ah
; C:\DOCUMENTS AND SETTINGS\LG_PC\DESKTOP\SPARK_LCD\RTC_EEPROM\12F683_SAAT_ISI_2.PBP	00001	A0003C	'****************************************************************
T3              		EQU	RAM_START + 01Ch
; C:\DOCUMENTS AND SETTINGS\LG_PC\DESKTOP\SPARK_LCD\RTC_EEPROM\12F683_SAAT_ISI_2.PBP	00001	A0003E	'****************************************************************
T4              		EQU	RAM_START + 01Eh
; C:\DOCUMENTS AND SETTINGS\LG_PC\DESKTOP\SPARK_LCD\RTC_EEPROM\12F683_SAAT_ISI_2.PBP	00001	A00040	'****************************************************************
T5              		EQU	RAM_START + 020h
; C:\DOCUMENTS AND SETTINGS\LG_PC\DESKTOP\SPARK_LCD\RTC_EEPROM\12F683_SAAT_ISI_2.PBP	00001	A00042	'****************************************************************
T6              		EQU	RAM_START + 022h
; C:\DOCUMENTS AND SETTINGS\LG_PC\DESKTOP\SPARK_LCD\RTC_EEPROM\12F683_SAAT_ISI_2.PBP	00001	A00044	'****************************************************************
T7              		EQU	RAM_START + 024h
; C:\DOCUMENTS AND SETTINGS\LG_PC\DESKTOP\SPARK_LCD\RTC_EEPROM\12F683_SAAT_ISI_2.PBP	00063	A00046	AY VAR BYTE
_AY              		EQU	RAM_START + 026h
; C:\DOCUMENTS AND SETTINGS\LG_PC\DESKTOP\SPARK_LCD\RTC_EEPROM\12F683_SAAT_ISI_2.PBP	00078	A00047	bos var byte
_bos             		EQU	RAM_START + 027h
; C:\DOCUMENTS AND SETTINGS\LG_PC\DESKTOP\SPARK_LCD\RTC_EEPROM\12F683_SAAT_ISI_2.PBP	00060	A00048	dak var byte
_dak             		EQU	RAM_START + 028h
; C:\DOCUMENTS AND SETTINGS\LG_PC\DESKTOP\SPARK_LCD\RTC_EEPROM\12F683_SAAT_ISI_2.PBP	00080	A00049	datesay var byte
_datesay         		EQU	RAM_START + 029h
; C:\DOCUMENTS AND SETTINGS\LG_PC\DESKTOP\SPARK_LCD\RTC_EEPROM\12F683_SAAT_ISI_2.PBP	00071	A0004A	den var byte  
_den             		EQU	RAM_START + 02Ah
; C:\DOCUMENTS AND SETTINGS\LG_PC\DESKTOP\SPARK_LCD\RTC_EEPROM\12F683_SAAT_ISI_2.PBP	00053	A0004B	gosay var byte
_gosay           		EQU	RAM_START + 02Bh
; C:\DOCUMENTS AND SETTINGS\LG_PC\DESKTOP\SPARK_LCD\RTC_EEPROM\12F683_SAAT_ISI_2.PBP	00049	A0004C	gosdak var byte
_gosdak          		EQU	RAM_START + 02Ch
; C:\DOCUMENTS AND SETTINGS\LG_PC\DESKTOP\SPARK_LCD\RTC_EEPROM\12F683_SAAT_ISI_2.PBP	00073	A0004D	gosden var byte
_gosden          		EQU	RAM_START + 02Dh
; C:\DOCUMENTS AND SETTINGS\LG_PC\DESKTOP\SPARK_LCD\RTC_EEPROM\12F683_SAAT_ISI_2.PBP	00052	A0004E	gosgun var byte
_gosgun          		EQU	RAM_START + 02Eh
; C:\DOCUMENTS AND SETTINGS\LG_PC\DESKTOP\SPARK_LCD\RTC_EEPROM\12F683_SAAT_ISI_2.PBP	00048	A0004F	gossaat var byte
_gossaat         		EQU	RAM_START + 02Fh
; C:\DOCUMENTS AND SETTINGS\LG_PC\DESKTOP\SPARK_LCD\RTC_EEPROM\12F683_SAAT_ISI_2.PBP	00050	A00050	gossn var byte
_gossn           		EQU	RAM_START + 030h
; C:\DOCUMENTS AND SETTINGS\LG_PC\DESKTOP\SPARK_LCD\RTC_EEPROM\12F683_SAAT_ISI_2.PBP	00054	A00051	GOSYIL VAR BYTE
_GOSYIL          		EQU	RAM_START + 031h
; C:\DOCUMENTS AND SETTINGS\LG_PC\DESKTOP\SPARK_LCD\RTC_EEPROM\12F683_SAAT_ISI_2.PBP	00062	A00052	GUN VAR BYTE
_GUN             		EQU	RAM_START + 032h
; C:\DOCUMENTS AND SETTINGS\LG_PC\DESKTOP\SPARK_LCD\RTC_EEPROM\12F683_SAAT_ISI_2.PBP	00065	A00053	HAFGUN VAR BYTE
_HAFGUN          		EQU	RAM_START + 033h
; C:\DOCUMENTS AND SETTINGS\LG_PC\DESKTOP\SPARK_LCD\RTC_EEPROM\12F683_SAAT_ISI_2.PBP	00075	A00054	hesap var byte
_hesap           		EQU	RAM_START + 034h
; C:\DOCUMENTS AND SETTINGS\LG_PC\DESKTOP\SPARK_LCD\RTC_EEPROM\12F683_SAAT_ISI_2.PBP	00076	A00055	k var byte
_k               		EQU	RAM_START + 035h
; C:\DOCUMENTS AND SETTINGS\LG_PC\DESKTOP\SPARK_LCD\RTC_EEPROM\12F683_SAAT_ISI_2.PBP	00059	A00056	saat var byte
_saat            		EQU	RAM_START + 036h
; C:\DOCUMENTS AND SETTINGS\LG_PC\DESKTOP\SPARK_LCD\RTC_EEPROM\12F683_SAAT_ISI_2.PBP	00079	A00057	SENSSAY VAR BYTE
_SENSSAY         		EQU	RAM_START + 037h
; C:\DOCUMENTS AND SETTINGS\LG_PC\DESKTOP\SPARK_LCD\RTC_EEPROM\12F683_SAAT_ISI_2.PBP	00061	A00058	sn var byte 
_sn              		EQU	RAM_START + 038h
; C:\DOCUMENTS AND SETTINGS\LG_PC\DESKTOP\SPARK_LCD\RTC_EEPROM\12F683_SAAT_ISI_2.PBP	00057	A00059	TEMP VAR BYTE
_TEMP            		EQU	RAM_START + 039h
; C:\DOCUMENTS AND SETTINGS\LG_PC\DESKTOP\SPARK_LCD\RTC_EEPROM\12F683_SAAT_ISI_2.PBP	00072	A0005A	yer var byte
_yer             		EQU	RAM_START + 03Ah
; C:\DOCUMENTS AND SETTINGS\LG_PC\DESKTOP\SPARK_LCD\RTC_EEPROM\12F683_SAAT_ISI_2.PBP	00064	A0005B	YIL VAR BYTE
_YIL             		EQU	RAM_START + 03Bh
; C:\DOCUMENTS AND SETTINGS\LG_PC\DESKTOP\SPARK_LCD\RTC_EEPROM\12F683_SAAT_ISI_2.PBP	00074	A0005C	yilarti var byte
_yilarti         		EQU	RAM_START + 03Ch
; C:\DOCUMENTS AND SETTINGS\LG_PC\DESKTOP\SPARK_LCD\RTC_EEPROM\12F683_SAAT_ISI_2.PBP	00070	A0005D	yon var byte
_yon             		EQU	RAM_START + 03Dh
; C:\PBP3\DEVICES\PIC12F683.PBPINC	00140	PORTL   VAR     GPIO
_PORTL           		EQU	 GPIO
; C:\PBP3\DEVICES\PIC12F683.PBPINC	00141	PORTH   VAR     GPIO
_PORTH           		EQU	 GPIO
; C:\PBP3\DEVICES\PIC12F683.PBPINC	00142	TRISL   VAR     TRISIO
_TRISL           		EQU	 TRISIO
; C:\PBP3\DEVICES\PIC12F683.PBPINC	00143	TRISH   VAR     TRISIO
_TRISH           		EQU	 TRISIO
#define _SCL             	_GPIO??1
#define _SDA             	_GPIO??0
#define _GPIO??1         	 GPIO, 001h
#define _GPIO??0         	 GPIO, 000h
#define _GPIO??5         	 GPIO, 005h
#define _GPIO??2         	 GPIO, 002h
#define _GPIO??3         	 GPIO, 003h
#define _GPIO??4         	 GPIO, 004h
#define _STATUS??0       	 STATUS, 000h
	INCLUDE	"12F683_SAAT_ISI_2.MAC"
	INCLUDE	"C:\PBP3\PBPPIC14.LIB"


; C:\PBP3\DEVICES\PIC12F683.PBPINC	00036	#HEADER
; C:\PBP3\DEVICES\PIC12F683.PBPINC	00061	#CONFIG
; C:\PBP3\DEVICES\PIC12F683.PBPINC	00130	BANK0   $0020, $007F
; C:\PBP3\DEVICES\PIC12F683.PBPINC	00131	BANK1   $00A0, $00BF
; C:\PBP3\DEVICES\PIC12F683.PBPINC	00133	EEPROM  $2100, $21FF
; C:\PBP3\DEVICES\PIC12F683.PBPINC	00135	    #ERROR "-n option (PBPL) is not supported for this device."
; C:\PBP3\DEVICES\PIC12F683.PBPINC	00136	#ENDIF
; C:\PBP3\DEVICES\PIC12F683.PBPINC	00137	LIBRARY "PBPPIC14"
; C:\PBP3\DEVICES\PIC12F683.PBPINC	00138	DEFINE	CCP1_REG GPIO
; C:\PBP3\DEVICES\PIC12F683.PBPINC	00139	DEFINE	CCP1_BIT 2

; C:\PBP3\DEVICES\PIC12F683.PBPINC	00144	include "PBPPIC14.RAM"
; C:\PBP3\DEVICES\PIC12F683.PBPINC	00148	#HEADER
; C:\DOCUMENTS AND SETTINGS\LG_PC\DESKTOP\SPARK_LCD\RTC_EEPROM\12F683_SAAT_ISI_2.PBP	00011	DEFINE OSC 8
; C:\DOCUMENTS AND SETTINGS\LG_PC\DESKTOP\SPARK_LCD\RTC_EEPROM\12F683_SAAT_ISI_2.PBP	00014	#config

; C:\DOCUMENTS AND SETTINGS\LG_PC\DESKTOP\SPARK_LCD\RTC_EEPROM\12F683_SAAT_ISI_2.PBP	00019	OSCCON=%01110101   ; Ýlk programa dönüþ için osccal deðerini kapat. 
	MOVE?CB	075h, OSCCON

; C:\DOCUMENTS AND SETTINGS\LG_PC\DESKTOP\SPARK_LCD\RTC_EEPROM\12F683_SAAT_ISI_2.PBP	00020	CMCON0 = 7
	MOVE?CB	007h, CMCON0

; C:\DOCUMENTS AND SETTINGS\LG_PC\DESKTOP\SPARK_LCD\RTC_EEPROM\12F683_SAAT_ISI_2.PBP	00021	ADCON0=%00000000
	MOVE?CB	000h, ADCON0

; C:\DOCUMENTS AND SETTINGS\LG_PC\DESKTOP\SPARK_LCD\RTC_EEPROM\12F683_SAAT_ISI_2.PBP	00022	ANSEL=0 ;ADC ler iptal
	MOVE?CB	000h, ANSEL

; C:\DOCUMENTS AND SETTINGS\LG_PC\DESKTOP\SPARK_LCD\RTC_EEPROM\12F683_SAAT_ISI_2.PBP	00041	TRISIO=%00011100
	MOVE?CB	01Ch, TRISIO

; C:\DOCUMENTS AND SETTINGS\LG_PC\DESKTOP\SPARK_LCD\RTC_EEPROM\12F683_SAAT_ISI_2.PBP	00096	clear 
	CLEAR?	

; C:\DOCUMENTS AND SETTINGS\LG_PC\DESKTOP\SPARK_LCD\RTC_EEPROM\12F683_SAAT_ISI_2.PBP	00098	pause 100
	PAUSE?C	064h

; C:\DOCUMENTS AND SETTINGS\LG_PC\DESKTOP\SPARK_LCD\RTC_EEPROM\12F683_SAAT_ISI_2.PBP	00099	SEROUT2 GPIO.5,84,["LCDDD"]
	SEROUT2DPIN?T	_GPIO??5
	SEROUT2MODE?C	054h
	SEROUT2PACE?C	000h
	SEROUT2?C	04Ch
	SEROUT2?C	043h
	SEROUT2?C	044h
	SEROUT2?C	044h
	SEROUT2?C	044h

; C:\DOCUMENTS AND SETTINGS\LG_PC\DESKTOP\SPARK_LCD\RTC_EEPROM\12F683_SAAT_ISI_2.PBP	00100	 pause 25
	PAUSE?C	019h

; C:\DOCUMENTS AND SETTINGS\LG_PC\DESKTOP\SPARK_LCD\RTC_EEPROM\12F683_SAAT_ISI_2.PBP	00101	 SEROUT2 GPIO.5,84,["LCDBO"]
	SEROUT2DPIN?T	_GPIO??5
	SEROUT2MODE?C	054h
	SEROUT2PACE?C	000h
	SEROUT2?C	04Ch
	SEROUT2?C	043h
	SEROUT2?C	044h
	SEROUT2?C	042h
	SEROUT2?C	04Fh

; C:\DOCUMENTS AND SETTINGS\LG_PC\DESKTOP\SPARK_LCD\RTC_EEPROM\12F683_SAAT_ISI_2.PBP	00102	 pause 25
	PAUSE?C	019h

; C:\DOCUMENTS AND SETTINGS\LG_PC\DESKTOP\SPARK_LCD\RTC_EEPROM\12F683_SAAT_ISI_2.PBP	00103	 SEROUT2 GPIO.5,84,["LCDBL 6"]
	SEROUT2DPIN?T	_GPIO??5
	SEROUT2MODE?C	054h
	SEROUT2PACE?C	000h
	SEROUT2?C	04Ch
	SEROUT2?C	043h
	SEROUT2?C	044h
	SEROUT2?C	042h
	SEROUT2?C	04Ch
	SEROUT2?C	020h
	SEROUT2?C	036h

; C:\DOCUMENTS AND SETTINGS\LG_PC\DESKTOP\SPARK_LCD\RTC_EEPROM\12F683_SAAT_ISI_2.PBP	00104	 pause 25
	PAUSE?C	019h

; C:\DOCUMENTS AND SETTINGS\LG_PC\DESKTOP\SPARK_LCD\RTC_EEPROM\12F683_SAAT_ISI_2.PBP	00109	 I2CWrite SDA,SCL,$D0,$07,[%00010000]
	I2CDATA?T	_SDA
	I2CCLOCK?T	_SCL
	I2CWRITE?C	0D0h
	I2CWRITE?C	007h
	I2CWRITES?C	010h

; C:\DOCUMENTS AND SETTINGS\LG_PC\DESKTOP\SPARK_LCD\RTC_EEPROM\12F683_SAAT_ISI_2.PBP	00112	AYAR:

	LABEL?L	_AYAR	

; C:\DOCUMENTS AND SETTINGS\LG_PC\DESKTOP\SPARK_LCD\RTC_EEPROM\12F683_SAAT_ISI_2.PBP	00113	  SEROUT2 GPIO.5,84,["LCDCH"]
	SEROUT2DPIN?T	_GPIO??5
	SEROUT2MODE?C	054h
	SEROUT2PACE?C	000h
	SEROUT2?C	04Ch
	SEROUT2?C	043h
	SEROUT2?C	044h
	SEROUT2?C	043h
	SEROUT2?C	048h

; C:\DOCUMENTS AND SETTINGS\LG_PC\DESKTOP\SPARK_LCD\RTC_EEPROM\12F683_SAAT_ISI_2.PBP	00114	  pause 25
	PAUSE?C	019h

; C:\DOCUMENTS AND SETTINGS\LG_PC\DESKTOP\SPARK_LCD\RTC_EEPROM\12F683_SAAT_ISI_2.PBP	00115	  while gpio.2=0
	LABEL?L	L00001	
	CMPNE?TCL	_GPIO??2, 000h, L00002

; C:\DOCUMENTS AND SETTINGS\LG_PC\DESKTOP\SPARK_LCD\RTC_EEPROM\12F683_SAAT_ISI_2.PBP	00116	wend
	GOTO?L	L00001
	LABEL?L	L00002	

; C:\DOCUMENTS AND SETTINGS\LG_PC\DESKTOP\SPARK_LCD\RTC_EEPROM\12F683_SAAT_ISI_2.PBP	00117	AYAR1:   

	LABEL?L	_AYAR1	

; C:\DOCUMENTS AND SETTINGS\LG_PC\DESKTOP\SPARK_LCD\RTC_EEPROM\12F683_SAAT_ISI_2.PBP	00122	    GOSUB saatoku
	GOSUB?L	_saatoku

; C:\DOCUMENTS AND SETTINGS\LG_PC\DESKTOP\SPARK_LCD\RTC_EEPROM\12F683_SAAT_ISI_2.PBP	00125	  IF GPIO.2 =0 THEN 
	CMPNE?TCL	_GPIO??2, 000h, L00003

; C:\DOCUMENTS AND SETTINGS\LG_PC\DESKTOP\SPARK_LCD\RTC_EEPROM\12F683_SAAT_ISI_2.PBP	00126	  goto SAATAYAR1
	GOTO?L	_SAATAYAR1

; C:\DOCUMENTS AND SETTINGS\LG_PC\DESKTOP\SPARK_LCD\RTC_EEPROM\12F683_SAAT_ISI_2.PBP	00127	endif   
	LABEL?L	L00003	

; C:\DOCUMENTS AND SETTINGS\LG_PC\DESKTOP\SPARK_LCD\RTC_EEPROM\12F683_SAAT_ISI_2.PBP	00129	     PAUSE 100
	PAUSE?C	064h

; C:\DOCUMENTS AND SETTINGS\LG_PC\DESKTOP\SPARK_LCD\RTC_EEPROM\12F683_SAAT_ISI_2.PBP	00131	    GOTO AYAR1
	GOTO?L	_AYAR1

; C:\DOCUMENTS AND SETTINGS\LG_PC\DESKTOP\SPARK_LCD\RTC_EEPROM\12F683_SAAT_ISI_2.PBP	00133	SAATAYAR1 :

	LABEL?L	_SAATAYAR1	

; C:\DOCUMENTS AND SETTINGS\LG_PC\DESKTOP\SPARK_LCD\RTC_EEPROM\12F683_SAAT_ISI_2.PBP	00134	SEROUT2 GPIO.5,84,["LCDCB"]
	SEROUT2DPIN?T	_GPIO??5
	SEROUT2MODE?C	054h
	SEROUT2PACE?C	000h
	SEROUT2?C	04Ch
	SEROUT2?C	043h
	SEROUT2?C	044h
	SEROUT2?C	043h
	SEROUT2?C	042h

; C:\DOCUMENTS AND SETTINGS\LG_PC\DESKTOP\SPARK_LCD\RTC_EEPROM\12F683_SAAT_ISI_2.PBP	00138	pause 25
	PAUSE?C	019h

; C:\DOCUMENTS AND SETTINGS\LG_PC\DESKTOP\SPARK_LCD\RTC_EEPROM\12F683_SAAT_ISI_2.PBP	00139	 SEROUT2 GPIO.5,84,["LCDWR 1,7-"]
	SEROUT2DPIN?T	_GPIO??5
	SEROUT2MODE?C	054h
	SEROUT2PACE?C	000h
	SEROUT2?C	04Ch
	SEROUT2?C	043h
	SEROUT2?C	044h
	SEROUT2?C	057h
	SEROUT2?C	052h
	SEROUT2?C	020h
	SEROUT2?C	031h
	SEROUT2?C	02Ch
	SEROUT2?C	037h
	SEROUT2?C	02Dh

; C:\DOCUMENTS AND SETTINGS\LG_PC\DESKTOP\SPARK_LCD\RTC_EEPROM\12F683_SAAT_ISI_2.PBP	00140	While gpio.2=0
	LABEL?L	L00005	
	CMPNE?TCL	_GPIO??2, 000h, L00006

; C:\DOCUMENTS AND SETTINGS\LG_PC\DESKTOP\SPARK_LCD\RTC_EEPROM\12F683_SAAT_ISI_2.PBP	00141	wend
	GOTO?L	L00005
	LABEL?L	L00006	

; C:\DOCUMENTS AND SETTINGS\LG_PC\DESKTOP\SPARK_LCD\RTC_EEPROM\12F683_SAAT_ISI_2.PBP	00142	pause 25
	PAUSE?C	019h

; C:\DOCUMENTS AND SETTINGS\LG_PC\DESKTOP\SPARK_LCD\RTC_EEPROM\12F683_SAAT_ISI_2.PBP	00145	saatayar:

	LABEL?L	_saatayar	

; C:\DOCUMENTS AND SETTINGS\LG_PC\DESKTOP\SPARK_LCD\RTC_EEPROM\12F683_SAAT_ISI_2.PBP	00146	temp=saat
	MOVE?BB	_saat, _TEMP

; C:\DOCUMENTS AND SETTINGS\LG_PC\DESKTOP\SPARK_LCD\RTC_EEPROM\12F683_SAAT_ISI_2.PBP	00149	yer=1
	MOVE?CB	001h, _yer

; C:\DOCUMENTS AND SETTINGS\LG_PC\DESKTOP\SPARK_LCD\RTC_EEPROM\12F683_SAAT_ISI_2.PBP	00154	bak:

	LABEL?L	_bak	

; C:\DOCUMENTS AND SETTINGS\LG_PC\DESKTOP\SPARK_LCD\RTC_EEPROM\12F683_SAAT_ISI_2.PBP	00155	if GPIO.2=0 then goto dakayar
	CMPNE?TCL	_GPIO??2, 000h, L00007
	GOTO?L	_dakayar
	LABEL?L	L00007	

; C:\DOCUMENTS AND SETTINGS\LG_PC\DESKTOP\SPARK_LCD\RTC_EEPROM\12F683_SAAT_ISI_2.PBP	00156	if GPIO.3=0 then yon=1:goto saatayar2
	CMPNE?TCL	_GPIO??3, 000h, L00009
	MOVE?CB	001h, _yon
	GOTO?L	_saatayar2
	LABEL?L	L00009	

; C:\DOCUMENTS AND SETTINGS\LG_PC\DESKTOP\SPARK_LCD\RTC_EEPROM\12F683_SAAT_ISI_2.PBP	00157	if GPIO.4=0 then yon=2:goto saatayar2
	CMPNE?TCL	_GPIO??4, 000h, L00011
	MOVE?CB	002h, _yon
	GOTO?L	_saatayar2
	LABEL?L	L00011	

; C:\DOCUMENTS AND SETTINGS\LG_PC\DESKTOP\SPARK_LCD\RTC_EEPROM\12F683_SAAT_ISI_2.PBP	00158	goto bak
	GOTO?L	_bak

; C:\DOCUMENTS AND SETTINGS\LG_PC\DESKTOP\SPARK_LCD\RTC_EEPROM\12F683_SAAT_ISI_2.PBP	00160	saatayar2:

	LABEL?L	_saatayar2	

; C:\DOCUMENTS AND SETTINGS\LG_PC\DESKTOP\SPARK_LCD\RTC_EEPROM\12F683_SAAT_ISI_2.PBP	00161	if yon=2 then goto asagi
	CMPNE?BCL	_yon, 002h, L00013
	GOTO?L	_asagi
	LABEL?L	L00013	

; C:\DOCUMENTS AND SETTINGS\LG_PC\DESKTOP\SPARK_LCD\RTC_EEPROM\12F683_SAAT_ISI_2.PBP	00162	if temp>22 then 
	CMPLE?BCL	_TEMP, 016h, L00015

; C:\DOCUMENTS AND SETTINGS\LG_PC\DESKTOP\SPARK_LCD\RTC_EEPROM\12F683_SAAT_ISI_2.PBP	00163	temp=0
	MOVE?CB	000h, _TEMP

; C:\DOCUMENTS AND SETTINGS\LG_PC\DESKTOP\SPARK_LCD\RTC_EEPROM\12F683_SAAT_ISI_2.PBP	00164	goto yazdir
	GOTO?L	_yazdir

; C:\DOCUMENTS AND SETTINGS\LG_PC\DESKTOP\SPARK_LCD\RTC_EEPROM\12F683_SAAT_ISI_2.PBP	00165	else
	GOTO?L	L00016
	LABEL?L	L00015	

; C:\DOCUMENTS AND SETTINGS\LG_PC\DESKTOP\SPARK_LCD\RTC_EEPROM\12F683_SAAT_ISI_2.PBP	00166	temp=temp+1
	ADD?BCB	_TEMP, 001h, _TEMP

; C:\DOCUMENTS AND SETTINGS\LG_PC\DESKTOP\SPARK_LCD\RTC_EEPROM\12F683_SAAT_ISI_2.PBP	00167	goto yazdir
	GOTO?L	_yazdir

; C:\DOCUMENTS AND SETTINGS\LG_PC\DESKTOP\SPARK_LCD\RTC_EEPROM\12F683_SAAT_ISI_2.PBP	00168	endif
	LABEL?L	L00016	

; C:\DOCUMENTS AND SETTINGS\LG_PC\DESKTOP\SPARK_LCD\RTC_EEPROM\12F683_SAAT_ISI_2.PBP	00169	goto bak 
	GOTO?L	_bak

; C:\DOCUMENTS AND SETTINGS\LG_PC\DESKTOP\SPARK_LCD\RTC_EEPROM\12F683_SAAT_ISI_2.PBP	00171	asagi:

	LABEL?L	_asagi	

; C:\DOCUMENTS AND SETTINGS\LG_PC\DESKTOP\SPARK_LCD\RTC_EEPROM\12F683_SAAT_ISI_2.PBP	00172	if temp=0 then temp=23:goto yazdir
	CMPNE?BCL	_TEMP, 000h, L00017
	MOVE?CB	017h, _TEMP
	GOTO?L	_yazdir
	LABEL?L	L00017	

; C:\DOCUMENTS AND SETTINGS\LG_PC\DESKTOP\SPARK_LCD\RTC_EEPROM\12F683_SAAT_ISI_2.PBP	00174	if temp<2 then 
	CMPGE?BCL	_TEMP, 002h, L00019

; C:\DOCUMENTS AND SETTINGS\LG_PC\DESKTOP\SPARK_LCD\RTC_EEPROM\12F683_SAAT_ISI_2.PBP	00175	temp=0
	MOVE?CB	000h, _TEMP

; C:\DOCUMENTS AND SETTINGS\LG_PC\DESKTOP\SPARK_LCD\RTC_EEPROM\12F683_SAAT_ISI_2.PBP	00176	goto yazdir
	GOTO?L	_yazdir

; C:\DOCUMENTS AND SETTINGS\LG_PC\DESKTOP\SPARK_LCD\RTC_EEPROM\12F683_SAAT_ISI_2.PBP	00177	else 
	GOTO?L	L00020
	LABEL?L	L00019	

; C:\DOCUMENTS AND SETTINGS\LG_PC\DESKTOP\SPARK_LCD\RTC_EEPROM\12F683_SAAT_ISI_2.PBP	00178	temp=temp-1
	SUB?BCB	_TEMP, 001h, _TEMP

; C:\DOCUMENTS AND SETTINGS\LG_PC\DESKTOP\SPARK_LCD\RTC_EEPROM\12F683_SAAT_ISI_2.PBP	00179	goto yazdir
	GOTO?L	_yazdir

; C:\DOCUMENTS AND SETTINGS\LG_PC\DESKTOP\SPARK_LCD\RTC_EEPROM\12F683_SAAT_ISI_2.PBP	00180	endif
	LABEL?L	L00020	

; C:\DOCUMENTS AND SETTINGS\LG_PC\DESKTOP\SPARK_LCD\RTC_EEPROM\12F683_SAAT_ISI_2.PBP	00181	GOTO BAK
	GOTO?L	_bak

; C:\DOCUMENTS AND SETTINGS\LG_PC\DESKTOP\SPARK_LCD\RTC_EEPROM\12F683_SAAT_ISI_2.PBP	00184	yazdir:

	LABEL?L	_yazdir	

; C:\DOCUMENTS AND SETTINGS\LG_PC\DESKTOP\SPARK_LCD\RTC_EEPROM\12F683_SAAT_ISI_2.PBP	00185	select case yer

; C:\DOCUMENTS AND SETTINGS\LG_PC\DESKTOP\SPARK_LCD\RTC_EEPROM\12F683_SAAT_ISI_2.PBP	00186	case 1
	CMPNE?BCL	_yer, 001h, L00023

; C:\DOCUMENTS AND SETTINGS\LG_PC\DESKTOP\SPARK_LCD\RTC_EEPROM\12F683_SAAT_ISI_2.PBP	00187	den=7   ;$86
	MOVE?CB	007h, _den

; C:\DOCUMENTS AND SETTINGS\LG_PC\DESKTOP\SPARK_LCD\RTC_EEPROM\12F683_SAAT_ISI_2.PBP	00188	saat=temp
	MOVE?BB	_TEMP, _saat

; C:\DOCUMENTS AND SETTINGS\LG_PC\DESKTOP\SPARK_LCD\RTC_EEPROM\12F683_SAAT_ISI_2.PBP	00189	case 2
	GOTO?L	L00022
	LABEL?L	L00023	
	CMPNE?BCL	_yer, 002h, L00024

; C:\DOCUMENTS AND SETTINGS\LG_PC\DESKTOP\SPARK_LCD\RTC_EEPROM\12F683_SAAT_ISI_2.PBP	00190	den=10  ;$89
	MOVE?CB	00Ah, _den

; C:\DOCUMENTS AND SETTINGS\LG_PC\DESKTOP\SPARK_LCD\RTC_EEPROM\12F683_SAAT_ISI_2.PBP	00191	dak=temp
	MOVE?BB	_TEMP, _dak

; C:\DOCUMENTS AND SETTINGS\LG_PC\DESKTOP\SPARK_LCD\RTC_EEPROM\12F683_SAAT_ISI_2.PBP	00192	case 3
	GOTO?L	L00022
	LABEL?L	L00024	
	CMPNE?BCL	_yer, 003h, L00025

; C:\DOCUMENTS AND SETTINGS\LG_PC\DESKTOP\SPARK_LCD\RTC_EEPROM\12F683_SAAT_ISI_2.PBP	00193	den=7   ;$c6                  ; burada 2. satýr için düzenleme yap c6 dediði yer 2. satýr olacak.*****************
	MOVE?CB	007h, _den

; C:\DOCUMENTS AND SETTINGS\LG_PC\DESKTOP\SPARK_LCD\RTC_EEPROM\12F683_SAAT_ISI_2.PBP	00194	gun=temp
	MOVE?BB	_TEMP, _GUN

; C:\DOCUMENTS AND SETTINGS\LG_PC\DESKTOP\SPARK_LCD\RTC_EEPROM\12F683_SAAT_ISI_2.PBP	00195	case 4
	GOTO?L	L00022
	LABEL?L	L00025	
	CMPNE?BCL	_yer, 004h, L00026

; C:\DOCUMENTS AND SETTINGS\LG_PC\DESKTOP\SPARK_LCD\RTC_EEPROM\12F683_SAAT_ISI_2.PBP	00196	den=10  ;$c9
	MOVE?CB	00Ah, _den

; C:\DOCUMENTS AND SETTINGS\LG_PC\DESKTOP\SPARK_LCD\RTC_EEPROM\12F683_SAAT_ISI_2.PBP	00197	ay=temp
	MOVE?BB	_TEMP, _AY

; C:\DOCUMENTS AND SETTINGS\LG_PC\DESKTOP\SPARK_LCD\RTC_EEPROM\12F683_SAAT_ISI_2.PBP	00198	case 5
	GOTO?L	L00022
	LABEL?L	L00026	
	CMPNE?BCL	_yer, 005h, L00027

; C:\DOCUMENTS AND SETTINGS\LG_PC\DESKTOP\SPARK_LCD\RTC_EEPROM\12F683_SAAT_ISI_2.PBP	00199	den=15  ;$Ce
	MOVE?CB	00Fh, _den

; C:\DOCUMENTS AND SETTINGS\LG_PC\DESKTOP\SPARK_LCD\RTC_EEPROM\12F683_SAAT_ISI_2.PBP	00200	yil=temp
	MOVE?BB	_TEMP, _YIL

; C:\DOCUMENTS AND SETTINGS\LG_PC\DESKTOP\SPARK_LCD\RTC_EEPROM\12F683_SAAT_ISI_2.PBP	00201	end select
	LABEL?L	L00027	
	LABEL?L	L00022	

; C:\DOCUMENTS AND SETTINGS\LG_PC\DESKTOP\SPARK_LCD\RTC_EEPROM\12F683_SAAT_ISI_2.PBP	00204	if yer<3 then 
	CMPGE?BCL	_yer, 003h, L00028

; C:\DOCUMENTS AND SETTINGS\LG_PC\DESKTOP\SPARK_LCD\RTC_EEPROM\12F683_SAAT_ISI_2.PBP	00205	SEROUT2 GPIO.5,84,["LCDWR 1,",dec2 DEN,"-",DEC2 TEMP]
	SEROUT2DPIN?T	_GPIO??5
	SEROUT2MODE?C	054h
	SEROUT2PACE?C	000h
	SEROUT2?C	04Ch
	SEROUT2?C	043h
	SEROUT2?C	044h
	SEROUT2?C	057h
	SEROUT2?C	052h
	SEROUT2?C	020h
	SEROUT2?C	031h
	SEROUT2?C	02Ch
	SEROUT2COUNT?C	002h
	SEROUT2NUM?B	_den
	SEROUT2DEC?	
	SEROUT2?C	02Dh
	SEROUT2COUNT?C	002h
	SEROUT2NUM?B	_TEMP
	SEROUT2DEC?	

; C:\DOCUMENTS AND SETTINGS\LG_PC\DESKTOP\SPARK_LCD\RTC_EEPROM\12F683_SAAT_ISI_2.PBP	00206	pause 100
	PAUSE?C	064h

; C:\DOCUMENTS AND SETTINGS\LG_PC\DESKTOP\SPARK_LCD\RTC_EEPROM\12F683_SAAT_ISI_2.PBP	00207	SEROUT2 GPIO.5,84,["LCDWR 1,",dec2 DEN,"-"]
	SEROUT2DPIN?T	_GPIO??5
	SEROUT2MODE?C	054h
	SEROUT2PACE?C	000h
	SEROUT2?C	04Ch
	SEROUT2?C	043h
	SEROUT2?C	044h
	SEROUT2?C	057h
	SEROUT2?C	052h
	SEROUT2?C	020h
	SEROUT2?C	031h
	SEROUT2?C	02Ch
	SEROUT2COUNT?C	002h
	SEROUT2NUM?B	_den
	SEROUT2DEC?	
	SEROUT2?C	02Dh

; C:\DOCUMENTS AND SETTINGS\LG_PC\DESKTOP\SPARK_LCD\RTC_EEPROM\12F683_SAAT_ISI_2.PBP	00208	pause 100    ;200
	PAUSE?C	064h

; C:\DOCUMENTS AND SETTINGS\LG_PC\DESKTOP\SPARK_LCD\RTC_EEPROM\12F683_SAAT_ISI_2.PBP	00209	endif
	LABEL?L	L00028	

; C:\DOCUMENTS AND SETTINGS\LG_PC\DESKTOP\SPARK_LCD\RTC_EEPROM\12F683_SAAT_ISI_2.PBP	00214	if yer>2 then 
	CMPLE?BCL	_yer, 002h, L00030

; C:\DOCUMENTS AND SETTINGS\LG_PC\DESKTOP\SPARK_LCD\RTC_EEPROM\12F683_SAAT_ISI_2.PBP	00215	SEROUT2 GPIO.5,84,["LCDWR 2,",dec2 DEN,"-",DEC2 TEMP]
	SEROUT2DPIN?T	_GPIO??5
	SEROUT2MODE?C	054h
	SEROUT2PACE?C	000h
	SEROUT2?C	04Ch
	SEROUT2?C	043h
	SEROUT2?C	044h
	SEROUT2?C	057h
	SEROUT2?C	052h
	SEROUT2?C	020h
	SEROUT2?C	032h
	SEROUT2?C	02Ch
	SEROUT2COUNT?C	002h
	SEROUT2NUM?B	_den
	SEROUT2DEC?	
	SEROUT2?C	02Dh
	SEROUT2COUNT?C	002h
	SEROUT2NUM?B	_TEMP
	SEROUT2DEC?	

; C:\DOCUMENTS AND SETTINGS\LG_PC\DESKTOP\SPARK_LCD\RTC_EEPROM\12F683_SAAT_ISI_2.PBP	00216	pause 100
	PAUSE?C	064h

; C:\DOCUMENTS AND SETTINGS\LG_PC\DESKTOP\SPARK_LCD\RTC_EEPROM\12F683_SAAT_ISI_2.PBP	00217	SEROUT2 GPIO.5,84,["LCDWR 2,",dec2 DEN,"-"]
	SEROUT2DPIN?T	_GPIO??5
	SEROUT2MODE?C	054h
	SEROUT2PACE?C	000h
	SEROUT2?C	04Ch
	SEROUT2?C	043h
	SEROUT2?C	044h
	SEROUT2?C	057h
	SEROUT2?C	052h
	SEROUT2?C	020h
	SEROUT2?C	032h
	SEROUT2?C	02Ch
	SEROUT2COUNT?C	002h
	SEROUT2NUM?B	_den
	SEROUT2DEC?	
	SEROUT2?C	02Dh

; C:\DOCUMENTS AND SETTINGS\LG_PC\DESKTOP\SPARK_LCD\RTC_EEPROM\12F683_SAAT_ISI_2.PBP	00218	pause 100    ;200
	PAUSE?C	064h

; C:\DOCUMENTS AND SETTINGS\LG_PC\DESKTOP\SPARK_LCD\RTC_EEPROM\12F683_SAAT_ISI_2.PBP	00219	endif
	LABEL?L	L00030	

; C:\DOCUMENTS AND SETTINGS\LG_PC\DESKTOP\SPARK_LCD\RTC_EEPROM\12F683_SAAT_ISI_2.PBP	00221	if yer=1 then goto bak
	CMPNE?BCL	_yer, 001h, L00032
	GOTO?L	_bak
	LABEL?L	L00032	

; C:\DOCUMENTS AND SETTINGS\LG_PC\DESKTOP\SPARK_LCD\RTC_EEPROM\12F683_SAAT_ISI_2.PBP	00222	if yer=2 then goto bakdak
	CMPNE?BCL	_yer, 002h, L00034
	GOTO?L	_bakdak
	LABEL?L	L00034	

; C:\DOCUMENTS AND SETTINGS\LG_PC\DESKTOP\SPARK_LCD\RTC_EEPROM\12F683_SAAT_ISI_2.PBP	00223	if yer=3 then goto gundak
	CMPNE?BCL	_yer, 003h, L00036
	GOTO?L	_gundak
	LABEL?L	L00036	

; C:\DOCUMENTS AND SETTINGS\LG_PC\DESKTOP\SPARK_LCD\RTC_EEPROM\12F683_SAAT_ISI_2.PBP	00224	if yer=4 then goto aydak
	CMPNE?BCL	_yer, 004h, L00038
	GOTO?L	_aydak
	LABEL?L	L00038	

; C:\DOCUMENTS AND SETTINGS\LG_PC\DESKTOP\SPARK_LCD\RTC_EEPROM\12F683_SAAT_ISI_2.PBP	00225	if yer=5 then goto yildak
	CMPNE?BCL	_yer, 005h, L00040
	GOTO?L	_yildak
	LABEL?L	L00040	

; C:\DOCUMENTS AND SETTINGS\LG_PC\DESKTOP\SPARK_LCD\RTC_EEPROM\12F683_SAAT_ISI_2.PBP	00230	dakayar:

	LABEL?L	_dakayar	

; C:\DOCUMENTS AND SETTINGS\LG_PC\DESKTOP\SPARK_LCD\RTC_EEPROM\12F683_SAAT_ISI_2.PBP	00231	yer=2
	MOVE?CB	002h, _yer

; C:\DOCUMENTS AND SETTINGS\LG_PC\DESKTOP\SPARK_LCD\RTC_EEPROM\12F683_SAAT_ISI_2.PBP	00232	temp=dak
	MOVE?BB	_dak, _TEMP

; C:\DOCUMENTS AND SETTINGS\LG_PC\DESKTOP\SPARK_LCD\RTC_EEPROM\12F683_SAAT_ISI_2.PBP	00234	SEROUT2 GPIO.5,84,["LCDWR 1,10-"]
	SEROUT2DPIN?T	_GPIO??5
	SEROUT2MODE?C	054h
	SEROUT2PACE?C	000h
	SEROUT2?C	04Ch
	SEROUT2?C	043h
	SEROUT2?C	044h
	SEROUT2?C	057h
	SEROUT2?C	052h
	SEROUT2?C	020h
	SEROUT2?C	031h
	SEROUT2?C	02Ch
	SEROUT2?C	031h
	SEROUT2?C	030h
	SEROUT2?C	02Dh

; C:\DOCUMENTS AND SETTINGS\LG_PC\DESKTOP\SPARK_LCD\RTC_EEPROM\12F683_SAAT_ISI_2.PBP	00235	pause 25
	PAUSE?C	019h

; C:\DOCUMENTS AND SETTINGS\LG_PC\DESKTOP\SPARK_LCD\RTC_EEPROM\12F683_SAAT_ISI_2.PBP	00236	While gpio.2=0
	LABEL?L	L00042	
	CMPNE?TCL	_GPIO??2, 000h, L00043

; C:\DOCUMENTS AND SETTINGS\LG_PC\DESKTOP\SPARK_LCD\RTC_EEPROM\12F683_SAAT_ISI_2.PBP	00237	wend
	GOTO?L	L00042
	LABEL?L	L00043	

; C:\DOCUMENTS AND SETTINGS\LG_PC\DESKTOP\SPARK_LCD\RTC_EEPROM\12F683_SAAT_ISI_2.PBP	00241	bakdak:

	LABEL?L	_bakdak	

; C:\DOCUMENTS AND SETTINGS\LG_PC\DESKTOP\SPARK_LCD\RTC_EEPROM\12F683_SAAT_ISI_2.PBP	00242	if GPIO.2=0 then goto yilayar
	CMPNE?TCL	_GPIO??2, 000h, L00044
	GOTO?L	_yilayar
	LABEL?L	L00044	

; C:\DOCUMENTS AND SETTINGS\LG_PC\DESKTOP\SPARK_LCD\RTC_EEPROM\12F683_SAAT_ISI_2.PBP	00243	if GPIO.3=0 then yon=1:goto dakayar2
	CMPNE?TCL	_GPIO??3, 000h, L00046
	MOVE?CB	001h, _yon
	GOTO?L	_dakayar2
	LABEL?L	L00046	

; C:\DOCUMENTS AND SETTINGS\LG_PC\DESKTOP\SPARK_LCD\RTC_EEPROM\12F683_SAAT_ISI_2.PBP	00244	if GPIO.4=0 then yon=2:goto dakayar2
	CMPNE?TCL	_GPIO??4, 000h, L00048
	MOVE?CB	002h, _yon
	GOTO?L	_dakayar2
	LABEL?L	L00048	

; C:\DOCUMENTS AND SETTINGS\LG_PC\DESKTOP\SPARK_LCD\RTC_EEPROM\12F683_SAAT_ISI_2.PBP	00245	goto bakdak
	GOTO?L	_bakdak

; C:\DOCUMENTS AND SETTINGS\LG_PC\DESKTOP\SPARK_LCD\RTC_EEPROM\12F683_SAAT_ISI_2.PBP	00247	dakayar2:

	LABEL?L	_dakayar2	

; C:\DOCUMENTS AND SETTINGS\LG_PC\DESKTOP\SPARK_LCD\RTC_EEPROM\12F683_SAAT_ISI_2.PBP	00248	if yon=2 then goto dakasa
	CMPNE?BCL	_yon, 002h, L00050
	GOTO?L	_dakasa
	LABEL?L	L00050	

; C:\DOCUMENTS AND SETTINGS\LG_PC\DESKTOP\SPARK_LCD\RTC_EEPROM\12F683_SAAT_ISI_2.PBP	00249	if temp>58 then 
	CMPLE?BCL	_TEMP, 03Ah, L00052

; C:\DOCUMENTS AND SETTINGS\LG_PC\DESKTOP\SPARK_LCD\RTC_EEPROM\12F683_SAAT_ISI_2.PBP	00250	temp=0
	MOVE?CB	000h, _TEMP

; C:\DOCUMENTS AND SETTINGS\LG_PC\DESKTOP\SPARK_LCD\RTC_EEPROM\12F683_SAAT_ISI_2.PBP	00251	goto yazdir
	GOTO?L	_yazdir

; C:\DOCUMENTS AND SETTINGS\LG_PC\DESKTOP\SPARK_LCD\RTC_EEPROM\12F683_SAAT_ISI_2.PBP	00252	else
	GOTO?L	L00053
	LABEL?L	L00052	

; C:\DOCUMENTS AND SETTINGS\LG_PC\DESKTOP\SPARK_LCD\RTC_EEPROM\12F683_SAAT_ISI_2.PBP	00253	temp=temp+1
	ADD?BCB	_TEMP, 001h, _TEMP

; C:\DOCUMENTS AND SETTINGS\LG_PC\DESKTOP\SPARK_LCD\RTC_EEPROM\12F683_SAAT_ISI_2.PBP	00254	goto yazdir
	GOTO?L	_yazdir

; C:\DOCUMENTS AND SETTINGS\LG_PC\DESKTOP\SPARK_LCD\RTC_EEPROM\12F683_SAAT_ISI_2.PBP	00255	endif
	LABEL?L	L00053	

; C:\DOCUMENTS AND SETTINGS\LG_PC\DESKTOP\SPARK_LCD\RTC_EEPROM\12F683_SAAT_ISI_2.PBP	00258	dakasa:

	LABEL?L	_dakasa	

; C:\DOCUMENTS AND SETTINGS\LG_PC\DESKTOP\SPARK_LCD\RTC_EEPROM\12F683_SAAT_ISI_2.PBP	00259	if temp=0 then temp=59:goto yazdir
	CMPNE?BCL	_TEMP, 000h, L00054
	MOVE?CB	03Bh, _TEMP
	GOTO?L	_yazdir
	LABEL?L	L00054	

; C:\DOCUMENTS AND SETTINGS\LG_PC\DESKTOP\SPARK_LCD\RTC_EEPROM\12F683_SAAT_ISI_2.PBP	00260	if temp<2 then 
	CMPGE?BCL	_TEMP, 002h, L00056

; C:\DOCUMENTS AND SETTINGS\LG_PC\DESKTOP\SPARK_LCD\RTC_EEPROM\12F683_SAAT_ISI_2.PBP	00261	temp=0
	MOVE?CB	000h, _TEMP

; C:\DOCUMENTS AND SETTINGS\LG_PC\DESKTOP\SPARK_LCD\RTC_EEPROM\12F683_SAAT_ISI_2.PBP	00262	goto yazdir
	GOTO?L	_yazdir

; C:\DOCUMENTS AND SETTINGS\LG_PC\DESKTOP\SPARK_LCD\RTC_EEPROM\12F683_SAAT_ISI_2.PBP	00263	else 
	GOTO?L	L00057
	LABEL?L	L00056	

; C:\DOCUMENTS AND SETTINGS\LG_PC\DESKTOP\SPARK_LCD\RTC_EEPROM\12F683_SAAT_ISI_2.PBP	00264	temp=temp-1
	SUB?BCB	_TEMP, 001h, _TEMP

; C:\DOCUMENTS AND SETTINGS\LG_PC\DESKTOP\SPARK_LCD\RTC_EEPROM\12F683_SAAT_ISI_2.PBP	00265	goto yazdir
	GOTO?L	_yazdir

; C:\DOCUMENTS AND SETTINGS\LG_PC\DESKTOP\SPARK_LCD\RTC_EEPROM\12F683_SAAT_ISI_2.PBP	00266	endif
	LABEL?L	L00057	

; C:\DOCUMENTS AND SETTINGS\LG_PC\DESKTOP\SPARK_LCD\RTC_EEPROM\12F683_SAAT_ISI_2.PBP	00272	gunayar:

	LABEL?L	_gunayar	

; C:\DOCUMENTS AND SETTINGS\LG_PC\DESKTOP\SPARK_LCD\RTC_EEPROM\12F683_SAAT_ISI_2.PBP	00273	yer=3
	MOVE?CB	003h, _yer

; C:\DOCUMENTS AND SETTINGS\LG_PC\DESKTOP\SPARK_LCD\RTC_EEPROM\12F683_SAAT_ISI_2.PBP	00274	temp=gun
	MOVE?BB	_GUN, _TEMP

; C:\DOCUMENTS AND SETTINGS\LG_PC\DESKTOP\SPARK_LCD\RTC_EEPROM\12F683_SAAT_ISI_2.PBP	00276	SEROUT2 GPIO.5,84,["LCDWR 2,7-"] 
	SEROUT2DPIN?T	_GPIO??5
	SEROUT2MODE?C	054h
	SEROUT2PACE?C	000h
	SEROUT2?C	04Ch
	SEROUT2?C	043h
	SEROUT2?C	044h
	SEROUT2?C	057h
	SEROUT2?C	052h
	SEROUT2?C	020h
	SEROUT2?C	032h
	SEROUT2?C	02Ch
	SEROUT2?C	037h
	SEROUT2?C	02Dh

; C:\DOCUMENTS AND SETTINGS\LG_PC\DESKTOP\SPARK_LCD\RTC_EEPROM\12F683_SAAT_ISI_2.PBP	00278	While gpio.2=0
	LABEL?L	L00058	
	CMPNE?TCL	_GPIO??2, 000h, L00059

; C:\DOCUMENTS AND SETTINGS\LG_PC\DESKTOP\SPARK_LCD\RTC_EEPROM\12F683_SAAT_ISI_2.PBP	00279	wend
	GOTO?L	L00058
	LABEL?L	L00059	

; C:\DOCUMENTS AND SETTINGS\LG_PC\DESKTOP\SPARK_LCD\RTC_EEPROM\12F683_SAAT_ISI_2.PBP	00282	 gundak:

	LABEL?L	_gundak	

; C:\DOCUMENTS AND SETTINGS\LG_PC\DESKTOP\SPARK_LCD\RTC_EEPROM\12F683_SAAT_ISI_2.PBP	00283	if GPIO.2=0 then 
	CMPNE?TCL	_GPIO??2, 000h, L00060

; C:\DOCUMENTS AND SETTINGS\LG_PC\DESKTOP\SPARK_LCD\RTC_EEPROM\12F683_SAAT_ISI_2.PBP	00284	gosub zaman_yaz
	GOSUB?L	_zaman_yaz

; C:\DOCUMENTS AND SETTINGS\LG_PC\DESKTOP\SPARK_LCD\RTC_EEPROM\12F683_SAAT_ISI_2.PBP	00286	goto ayar
	GOTO?L	_AYAR

; C:\DOCUMENTS AND SETTINGS\LG_PC\DESKTOP\SPARK_LCD\RTC_EEPROM\12F683_SAAT_ISI_2.PBP	00287	endif 
	LABEL?L	L00060	

; C:\DOCUMENTS AND SETTINGS\LG_PC\DESKTOP\SPARK_LCD\RTC_EEPROM\12F683_SAAT_ISI_2.PBP	00289	if GPIO.3=0 then yon=1:goto gunayar2
	CMPNE?TCL	_GPIO??3, 000h, L00062
	MOVE?CB	001h, _yon
	GOTO?L	_gunayar2
	LABEL?L	L00062	

; C:\DOCUMENTS AND SETTINGS\LG_PC\DESKTOP\SPARK_LCD\RTC_EEPROM\12F683_SAAT_ISI_2.PBP	00290	if GPIO.4=0 then yon=2:goto gunayar2
	CMPNE?TCL	_GPIO??4, 000h, L00064
	MOVE?CB	002h, _yon
	GOTO?L	_gunayar2
	LABEL?L	L00064	

; C:\DOCUMENTS AND SETTINGS\LG_PC\DESKTOP\SPARK_LCD\RTC_EEPROM\12F683_SAAT_ISI_2.PBP	00291	goto gundak
	GOTO?L	_gundak

; C:\DOCUMENTS AND SETTINGS\LG_PC\DESKTOP\SPARK_LCD\RTC_EEPROM\12F683_SAAT_ISI_2.PBP	00293	gunayar2:

	LABEL?L	_gunayar2	

; C:\DOCUMENTS AND SETTINGS\LG_PC\DESKTOP\SPARK_LCD\RTC_EEPROM\12F683_SAAT_ISI_2.PBP	00294	if ay=1 or ay=3 or ay=5 or ay=7 or ay=8 or ay=10 or ay=12 then 
	CMPEQ?BCB	_AY, 001h, T1
	CMPEQ?BCB	_AY, 003h, T2
	LOR?BBW	T1, T2, T2
	CMPEQ?BCB	_AY, 005h, T3
	LOR?WBW	T2, T3, T3
	CMPEQ?BCB	_AY, 007h, T4
	LOR?WBW	T3, T4, T4
	CMPEQ?BCB	_AY, 008h, T5
	LOR?WBW	T4, T5, T5
	CMPEQ?BCB	_AY, 00Ah, T6
	LOR?WBW	T5, T6, T6
	CMPEQ?BCB	_AY, 00Ch, T7
	LOR?WBW	T6, T7, T7
	CMPF?WL	T7, L00066

; C:\DOCUMENTS AND SETTINGS\LG_PC\DESKTOP\SPARK_LCD\RTC_EEPROM\12F683_SAAT_ISI_2.PBP	00295	gosden=31
	MOVE?CB	01Fh, _gosden

; C:\DOCUMENTS AND SETTINGS\LG_PC\DESKTOP\SPARK_LCD\RTC_EEPROM\12F683_SAAT_ISI_2.PBP	00296	else
	GOTO?L	L00067
	LABEL?L	L00066	

; C:\DOCUMENTS AND SETTINGS\LG_PC\DESKTOP\SPARK_LCD\RTC_EEPROM\12F683_SAAT_ISI_2.PBP	00297	gosden=30
	MOVE?CB	01Eh, _gosden

; C:\DOCUMENTS AND SETTINGS\LG_PC\DESKTOP\SPARK_LCD\RTC_EEPROM\12F683_SAAT_ISI_2.PBP	00298	endif
	LABEL?L	L00067	

; C:\DOCUMENTS AND SETTINGS\LG_PC\DESKTOP\SPARK_LCD\RTC_EEPROM\12F683_SAAT_ISI_2.PBP	00299	if yon=2 then goto gunasa
	CMPNE?BCL	_yon, 002h, L00068
	GOTO?L	_gunasa
	LABEL?L	L00068	

; C:\DOCUMENTS AND SETTINGS\LG_PC\DESKTOP\SPARK_LCD\RTC_EEPROM\12F683_SAAT_ISI_2.PBP	00300	if temp>gosden-1  then 
	SUB?BCW	_gosden, 001h, T1
	CMPLE?BWL	_TEMP, T1, L00070

; C:\DOCUMENTS AND SETTINGS\LG_PC\DESKTOP\SPARK_LCD\RTC_EEPROM\12F683_SAAT_ISI_2.PBP	00301	temp=1
	MOVE?CB	001h, _TEMP

; C:\DOCUMENTS AND SETTINGS\LG_PC\DESKTOP\SPARK_LCD\RTC_EEPROM\12F683_SAAT_ISI_2.PBP	00302	goto yazdir
	GOTO?L	_yazdir

; C:\DOCUMENTS AND SETTINGS\LG_PC\DESKTOP\SPARK_LCD\RTC_EEPROM\12F683_SAAT_ISI_2.PBP	00303	else
	GOTO?L	L00071
	LABEL?L	L00070	

; C:\DOCUMENTS AND SETTINGS\LG_PC\DESKTOP\SPARK_LCD\RTC_EEPROM\12F683_SAAT_ISI_2.PBP	00304	temp=temp+1
	ADD?BCB	_TEMP, 001h, _TEMP

; C:\DOCUMENTS AND SETTINGS\LG_PC\DESKTOP\SPARK_LCD\RTC_EEPROM\12F683_SAAT_ISI_2.PBP	00305	goto yazdir
	GOTO?L	_yazdir

; C:\DOCUMENTS AND SETTINGS\LG_PC\DESKTOP\SPARK_LCD\RTC_EEPROM\12F683_SAAT_ISI_2.PBP	00306	endif
	LABEL?L	L00071	

; C:\DOCUMENTS AND SETTINGS\LG_PC\DESKTOP\SPARK_LCD\RTC_EEPROM\12F683_SAAT_ISI_2.PBP	00308	gunasa:

	LABEL?L	_gunasa	

; C:\DOCUMENTS AND SETTINGS\LG_PC\DESKTOP\SPARK_LCD\RTC_EEPROM\12F683_SAAT_ISI_2.PBP	00309	if temp<2 then 
	CMPGE?BCL	_TEMP, 002h, L00072

; C:\DOCUMENTS AND SETTINGS\LG_PC\DESKTOP\SPARK_LCD\RTC_EEPROM\12F683_SAAT_ISI_2.PBP	00310	temp=gosden
	MOVE?BB	_gosden, _TEMP

; C:\DOCUMENTS AND SETTINGS\LG_PC\DESKTOP\SPARK_LCD\RTC_EEPROM\12F683_SAAT_ISI_2.PBP	00311	goto yazdir
	GOTO?L	_yazdir

; C:\DOCUMENTS AND SETTINGS\LG_PC\DESKTOP\SPARK_LCD\RTC_EEPROM\12F683_SAAT_ISI_2.PBP	00312	else 
	GOTO?L	L00073
	LABEL?L	L00072	

; C:\DOCUMENTS AND SETTINGS\LG_PC\DESKTOP\SPARK_LCD\RTC_EEPROM\12F683_SAAT_ISI_2.PBP	00313	temp=temp-1
	SUB?BCB	_TEMP, 001h, _TEMP

; C:\DOCUMENTS AND SETTINGS\LG_PC\DESKTOP\SPARK_LCD\RTC_EEPROM\12F683_SAAT_ISI_2.PBP	00314	goto yazdir
	GOTO?L	_yazdir

; C:\DOCUMENTS AND SETTINGS\LG_PC\DESKTOP\SPARK_LCD\RTC_EEPROM\12F683_SAAT_ISI_2.PBP	00315	endif
	LABEL?L	L00073	

; C:\DOCUMENTS AND SETTINGS\LG_PC\DESKTOP\SPARK_LCD\RTC_EEPROM\12F683_SAAT_ISI_2.PBP	00320	ayayar:

	LABEL?L	_ayayar	

; C:\DOCUMENTS AND SETTINGS\LG_PC\DESKTOP\SPARK_LCD\RTC_EEPROM\12F683_SAAT_ISI_2.PBP	00321	yer=4
	MOVE?CB	004h, _yer

; C:\DOCUMENTS AND SETTINGS\LG_PC\DESKTOP\SPARK_LCD\RTC_EEPROM\12F683_SAAT_ISI_2.PBP	00322	temp=ay
	MOVE?BB	_AY, _TEMP

; C:\DOCUMENTS AND SETTINGS\LG_PC\DESKTOP\SPARK_LCD\RTC_EEPROM\12F683_SAAT_ISI_2.PBP	00324	SEROUT2 GPIO.5,84,["LCDWR 2,10-"]                    
	SEROUT2DPIN?T	_GPIO??5
	SEROUT2MODE?C	054h
	SEROUT2PACE?C	000h
	SEROUT2?C	04Ch
	SEROUT2?C	043h
	SEROUT2?C	044h
	SEROUT2?C	057h
	SEROUT2?C	052h
	SEROUT2?C	020h
	SEROUT2?C	032h
	SEROUT2?C	02Ch
	SEROUT2?C	031h
	SEROUT2?C	030h
	SEROUT2?C	02Dh

; C:\DOCUMENTS AND SETTINGS\LG_PC\DESKTOP\SPARK_LCD\RTC_EEPROM\12F683_SAAT_ISI_2.PBP	00325	pause 25
	PAUSE?C	019h

; C:\DOCUMENTS AND SETTINGS\LG_PC\DESKTOP\SPARK_LCD\RTC_EEPROM\12F683_SAAT_ISI_2.PBP	00326	while gpio.2=0
	LABEL?L	L00074	
	CMPNE?TCL	_GPIO??2, 000h, L00075

; C:\DOCUMENTS AND SETTINGS\LG_PC\DESKTOP\SPARK_LCD\RTC_EEPROM\12F683_SAAT_ISI_2.PBP	00327	wend
	GOTO?L	L00074
	LABEL?L	L00075	

; C:\DOCUMENTS AND SETTINGS\LG_PC\DESKTOP\SPARK_LCD\RTC_EEPROM\12F683_SAAT_ISI_2.PBP	00332	aydak:

	LABEL?L	_aydak	

; C:\DOCUMENTS AND SETTINGS\LG_PC\DESKTOP\SPARK_LCD\RTC_EEPROM\12F683_SAAT_ISI_2.PBP	00333	if GPIO.2=0 then goto gunayar
	CMPNE?TCL	_GPIO??2, 000h, L00076
	GOTO?L	_gunayar
	LABEL?L	L00076	

; C:\DOCUMENTS AND SETTINGS\LG_PC\DESKTOP\SPARK_LCD\RTC_EEPROM\12F683_SAAT_ISI_2.PBP	00334	if GPIO.3=0 then yon=1:goto ayayar2
	CMPNE?TCL	_GPIO??3, 000h, L00078
	MOVE?CB	001h, _yon
	GOTO?L	_ayayar2
	LABEL?L	L00078	

; C:\DOCUMENTS AND SETTINGS\LG_PC\DESKTOP\SPARK_LCD\RTC_EEPROM\12F683_SAAT_ISI_2.PBP	00335	if GPIO.4=0 then yon=2:goto ayayar2
	CMPNE?TCL	_GPIO??4, 000h, L00080
	MOVE?CB	002h, _yon
	GOTO?L	_ayayar2
	LABEL?L	L00080	

; C:\DOCUMENTS AND SETTINGS\LG_PC\DESKTOP\SPARK_LCD\RTC_EEPROM\12F683_SAAT_ISI_2.PBP	00336	goto aydak
	GOTO?L	_aydak

; C:\DOCUMENTS AND SETTINGS\LG_PC\DESKTOP\SPARK_LCD\RTC_EEPROM\12F683_SAAT_ISI_2.PBP	00338	ayayar2:

	LABEL?L	_ayayar2	

; C:\DOCUMENTS AND SETTINGS\LG_PC\DESKTOP\SPARK_LCD\RTC_EEPROM\12F683_SAAT_ISI_2.PBP	00339	if yon=2 then goto ayasa
	CMPNE?BCL	_yon, 002h, L00082
	GOTO?L	_ayasa
	LABEL?L	L00082	

; C:\DOCUMENTS AND SETTINGS\LG_PC\DESKTOP\SPARK_LCD\RTC_EEPROM\12F683_SAAT_ISI_2.PBP	00340	if temp>11  then 
	CMPLE?BCL	_TEMP, 00Bh, L00084

; C:\DOCUMENTS AND SETTINGS\LG_PC\DESKTOP\SPARK_LCD\RTC_EEPROM\12F683_SAAT_ISI_2.PBP	00341	temp=1
	MOVE?CB	001h, _TEMP

; C:\DOCUMENTS AND SETTINGS\LG_PC\DESKTOP\SPARK_LCD\RTC_EEPROM\12F683_SAAT_ISI_2.PBP	00342	goto yazdir
	GOTO?L	_yazdir

; C:\DOCUMENTS AND SETTINGS\LG_PC\DESKTOP\SPARK_LCD\RTC_EEPROM\12F683_SAAT_ISI_2.PBP	00343	else
	GOTO?L	L00085
	LABEL?L	L00084	

; C:\DOCUMENTS AND SETTINGS\LG_PC\DESKTOP\SPARK_LCD\RTC_EEPROM\12F683_SAAT_ISI_2.PBP	00344	temp=temp+1
	ADD?BCB	_TEMP, 001h, _TEMP

; C:\DOCUMENTS AND SETTINGS\LG_PC\DESKTOP\SPARK_LCD\RTC_EEPROM\12F683_SAAT_ISI_2.PBP	00345	goto yazdir
	GOTO?L	_yazdir

; C:\DOCUMENTS AND SETTINGS\LG_PC\DESKTOP\SPARK_LCD\RTC_EEPROM\12F683_SAAT_ISI_2.PBP	00346	endif
	LABEL?L	L00085	

; C:\DOCUMENTS AND SETTINGS\LG_PC\DESKTOP\SPARK_LCD\RTC_EEPROM\12F683_SAAT_ISI_2.PBP	00348	ayasa:

	LABEL?L	_ayasa	

; C:\DOCUMENTS AND SETTINGS\LG_PC\DESKTOP\SPARK_LCD\RTC_EEPROM\12F683_SAAT_ISI_2.PBP	00349	if temp<2 then 
	CMPGE?BCL	_TEMP, 002h, L00086

; C:\DOCUMENTS AND SETTINGS\LG_PC\DESKTOP\SPARK_LCD\RTC_EEPROM\12F683_SAAT_ISI_2.PBP	00350	temp=12
	MOVE?CB	00Ch, _TEMP

; C:\DOCUMENTS AND SETTINGS\LG_PC\DESKTOP\SPARK_LCD\RTC_EEPROM\12F683_SAAT_ISI_2.PBP	00351	goto yazdir
	GOTO?L	_yazdir

; C:\DOCUMENTS AND SETTINGS\LG_PC\DESKTOP\SPARK_LCD\RTC_EEPROM\12F683_SAAT_ISI_2.PBP	00352	else 
	GOTO?L	L00087
	LABEL?L	L00086	

; C:\DOCUMENTS AND SETTINGS\LG_PC\DESKTOP\SPARK_LCD\RTC_EEPROM\12F683_SAAT_ISI_2.PBP	00353	temp=temp-1
	SUB?BCB	_TEMP, 001h, _TEMP

; C:\DOCUMENTS AND SETTINGS\LG_PC\DESKTOP\SPARK_LCD\RTC_EEPROM\12F683_SAAT_ISI_2.PBP	00354	goto yazdir
	GOTO?L	_yazdir

; C:\DOCUMENTS AND SETTINGS\LG_PC\DESKTOP\SPARK_LCD\RTC_EEPROM\12F683_SAAT_ISI_2.PBP	00355	endif
	LABEL?L	L00087	

; C:\DOCUMENTS AND SETTINGS\LG_PC\DESKTOP\SPARK_LCD\RTC_EEPROM\12F683_SAAT_ISI_2.PBP	00360	yilayar:

	LABEL?L	_yilayar	

; C:\DOCUMENTS AND SETTINGS\LG_PC\DESKTOP\SPARK_LCD\RTC_EEPROM\12F683_SAAT_ISI_2.PBP	00361	yer=5
	MOVE?CB	005h, _yer

; C:\DOCUMENTS AND SETTINGS\LG_PC\DESKTOP\SPARK_LCD\RTC_EEPROM\12F683_SAAT_ISI_2.PBP	00362	temp=yil
	MOVE?BB	_YIL, _TEMP

; C:\DOCUMENTS AND SETTINGS\LG_PC\DESKTOP\SPARK_LCD\RTC_EEPROM\12F683_SAAT_ISI_2.PBP	00364	SEROUT2 GPIO.5,84,["LCDWR 2,15-"] 
	SEROUT2DPIN?T	_GPIO??5
	SEROUT2MODE?C	054h
	SEROUT2PACE?C	000h
	SEROUT2?C	04Ch
	SEROUT2?C	043h
	SEROUT2?C	044h
	SEROUT2?C	057h
	SEROUT2?C	052h
	SEROUT2?C	020h
	SEROUT2?C	032h
	SEROUT2?C	02Ch
	SEROUT2?C	031h
	SEROUT2?C	035h
	SEROUT2?C	02Dh

; C:\DOCUMENTS AND SETTINGS\LG_PC\DESKTOP\SPARK_LCD\RTC_EEPROM\12F683_SAAT_ISI_2.PBP	00365	pause 25
	PAUSE?C	019h

; C:\DOCUMENTS AND SETTINGS\LG_PC\DESKTOP\SPARK_LCD\RTC_EEPROM\12F683_SAAT_ISI_2.PBP	00366	while gpio.2=0
	LABEL?L	L00088	
	CMPNE?TCL	_GPIO??2, 000h, L00089

; C:\DOCUMENTS AND SETTINGS\LG_PC\DESKTOP\SPARK_LCD\RTC_EEPROM\12F683_SAAT_ISI_2.PBP	00367	wend
	GOTO?L	L00088
	LABEL?L	L00089	

; C:\DOCUMENTS AND SETTINGS\LG_PC\DESKTOP\SPARK_LCD\RTC_EEPROM\12F683_SAAT_ISI_2.PBP	00371	 yildak:

	LABEL?L	_yildak	

; C:\DOCUMENTS AND SETTINGS\LG_PC\DESKTOP\SPARK_LCD\RTC_EEPROM\12F683_SAAT_ISI_2.PBP	00376	if GPIO.2=0 then goto ayayar
	CMPNE?TCL	_GPIO??2, 000h, L00090
	GOTO?L	_ayayar
	LABEL?L	L00090	

; C:\DOCUMENTS AND SETTINGS\LG_PC\DESKTOP\SPARK_LCD\RTC_EEPROM\12F683_SAAT_ISI_2.PBP	00377	if GPIO.3=0 then yon=1:goto yilayar2
	CMPNE?TCL	_GPIO??3, 000h, L00092
	MOVE?CB	001h, _yon
	GOTO?L	_yilayar2
	LABEL?L	L00092	

; C:\DOCUMENTS AND SETTINGS\LG_PC\DESKTOP\SPARK_LCD\RTC_EEPROM\12F683_SAAT_ISI_2.PBP	00378	if GPIO.4=0 then yon=2:goto yilayar2
	CMPNE?TCL	_GPIO??4, 000h, L00094
	MOVE?CB	002h, _yon
	GOTO?L	_yilayar2
	LABEL?L	L00094	

; C:\DOCUMENTS AND SETTINGS\LG_PC\DESKTOP\SPARK_LCD\RTC_EEPROM\12F683_SAAT_ISI_2.PBP	00379	goto yildak
	GOTO?L	_yildak

; C:\DOCUMENTS AND SETTINGS\LG_PC\DESKTOP\SPARK_LCD\RTC_EEPROM\12F683_SAAT_ISI_2.PBP	00381	yilayar2:

	LABEL?L	_yilayar2	

; C:\DOCUMENTS AND SETTINGS\LG_PC\DESKTOP\SPARK_LCD\RTC_EEPROM\12F683_SAAT_ISI_2.PBP	00382	if yon=2 then goto yilasa
	CMPNE?BCL	_yon, 002h, L00096
	GOTO?L	_yilasa
	LABEL?L	L00096	

; C:\DOCUMENTS AND SETTINGS\LG_PC\DESKTOP\SPARK_LCD\RTC_EEPROM\12F683_SAAT_ISI_2.PBP	00383	if temp>98  then 
	CMPLE?BCL	_TEMP, 062h, L00098

; C:\DOCUMENTS AND SETTINGS\LG_PC\DESKTOP\SPARK_LCD\RTC_EEPROM\12F683_SAAT_ISI_2.PBP	00384	temp=0
	MOVE?CB	000h, _TEMP

; C:\DOCUMENTS AND SETTINGS\LG_PC\DESKTOP\SPARK_LCD\RTC_EEPROM\12F683_SAAT_ISI_2.PBP	00385	yilarti=30
	MOVE?CB	01Eh, _yilarti

; C:\DOCUMENTS AND SETTINGS\LG_PC\DESKTOP\SPARK_LCD\RTC_EEPROM\12F683_SAAT_ISI_2.PBP	00387	goto yazdir
	GOTO?L	_yazdir

; C:\DOCUMENTS AND SETTINGS\LG_PC\DESKTOP\SPARK_LCD\RTC_EEPROM\12F683_SAAT_ISI_2.PBP	00388	else
	GOTO?L	L00099
	LABEL?L	L00098	

; C:\DOCUMENTS AND SETTINGS\LG_PC\DESKTOP\SPARK_LCD\RTC_EEPROM\12F683_SAAT_ISI_2.PBP	00389	temp=temp+1
	ADD?BCB	_TEMP, 001h, _TEMP

; C:\DOCUMENTS AND SETTINGS\LG_PC\DESKTOP\SPARK_LCD\RTC_EEPROM\12F683_SAAT_ISI_2.PBP	00390	goto yazdir
	GOTO?L	_yazdir

; C:\DOCUMENTS AND SETTINGS\LG_PC\DESKTOP\SPARK_LCD\RTC_EEPROM\12F683_SAAT_ISI_2.PBP	00391	endif
	LABEL?L	L00099	

; C:\DOCUMENTS AND SETTINGS\LG_PC\DESKTOP\SPARK_LCD\RTC_EEPROM\12F683_SAAT_ISI_2.PBP	00394	yilasa:

	LABEL?L	_yilasa	

; C:\DOCUMENTS AND SETTINGS\LG_PC\DESKTOP\SPARK_LCD\RTC_EEPROM\12F683_SAAT_ISI_2.PBP	00395	if yilarti=30 and temp=0 then 
	CMPEQ?BCB	_yilarti, 01Eh, T1
	CMPEQ?BCB	_TEMP, 000h, T2
	LAND?BBW	T1, T2, T2
	CMPF?WL	T2, L00100

; C:\DOCUMENTS AND SETTINGS\LG_PC\DESKTOP\SPARK_LCD\RTC_EEPROM\12F683_SAAT_ISI_2.PBP	00396	yilarti=20
	MOVE?CB	014h, _yilarti

; C:\DOCUMENTS AND SETTINGS\LG_PC\DESKTOP\SPARK_LCD\RTC_EEPROM\12F683_SAAT_ISI_2.PBP	00397	temp=99
	MOVE?CB	063h, _TEMP

; C:\DOCUMENTS AND SETTINGS\LG_PC\DESKTOP\SPARK_LCD\RTC_EEPROM\12F683_SAAT_ISI_2.PBP	00399	goto yazdir
	GOTO?L	_yazdir

; C:\DOCUMENTS AND SETTINGS\LG_PC\DESKTOP\SPARK_LCD\RTC_EEPROM\12F683_SAAT_ISI_2.PBP	00400	endif
	LABEL?L	L00100	

; C:\DOCUMENTS AND SETTINGS\LG_PC\DESKTOP\SPARK_LCD\RTC_EEPROM\12F683_SAAT_ISI_2.PBP	00401	if temp<2 then 
	CMPGE?BCL	_TEMP, 002h, L00102

; C:\DOCUMENTS AND SETTINGS\LG_PC\DESKTOP\SPARK_LCD\RTC_EEPROM\12F683_SAAT_ISI_2.PBP	00402	temp=0
	MOVE?CB	000h, _TEMP

; C:\DOCUMENTS AND SETTINGS\LG_PC\DESKTOP\SPARK_LCD\RTC_EEPROM\12F683_SAAT_ISI_2.PBP	00403	goto yazdir
	GOTO?L	_yazdir

; C:\DOCUMENTS AND SETTINGS\LG_PC\DESKTOP\SPARK_LCD\RTC_EEPROM\12F683_SAAT_ISI_2.PBP	00404	else 
	GOTO?L	L00103
	LABEL?L	L00102	

; C:\DOCUMENTS AND SETTINGS\LG_PC\DESKTOP\SPARK_LCD\RTC_EEPROM\12F683_SAAT_ISI_2.PBP	00405	temp=temp-1
	SUB?BCB	_TEMP, 001h, _TEMP

; C:\DOCUMENTS AND SETTINGS\LG_PC\DESKTOP\SPARK_LCD\RTC_EEPROM\12F683_SAAT_ISI_2.PBP	00406	goto yazdir
	GOTO?L	_yazdir

; C:\DOCUMENTS AND SETTINGS\LG_PC\DESKTOP\SPARK_LCD\RTC_EEPROM\12F683_SAAT_ISI_2.PBP	00407	endif
	LABEL?L	L00103	

; C:\DOCUMENTS AND SETTINGS\LG_PC\DESKTOP\SPARK_LCD\RTC_EEPROM\12F683_SAAT_ISI_2.PBP	00424	SAATOKU:

	LABEL?L	_saatoku	

; C:\DOCUMENTS AND SETTINGS\LG_PC\DESKTOP\SPARK_LCD\RTC_EEPROM\12F683_SAAT_ISI_2.PBP	00426	    I2CRead SDA, SCL,$D1,$00,[SN,DAK,SAAT,HAFGUN,GUN,AY,YIL,TEMP]
	I2CDATA?T	_SDA
	I2CCLOCK?T	_SCL
	I2CWRITE?C	0D1h
	I2CWRITE?C	000h
	I2CREAD?B	_sn
	I2CREAD?B	_dak
	I2CREAD?B	_saat
	I2CREAD?B	_HAFGUN
	I2CREAD?B	_GUN
	I2CREAD?B	_AY
	I2CREAD?B	_YIL
	I2CREADS?B	_TEMP

; C:\DOCUMENTS AND SETTINGS\LG_PC\DESKTOP\SPARK_LCD\RTC_EEPROM\12F683_SAAT_ISI_2.PBP	00427	         BOS=((sn>>4) & $0F)*10+(SN & $0F):sn=BOS
	SHIFTR?BCW	_sn, 004h, T1
	AND?WCW	T1, 00Fh, T1
	MUL?WCW	T1, 00Ah, T1
	AND?BCW	_sn, 00Fh, T2
	ADD?WWB	T1, T2, _bos

; C:\DOCUMENTS AND SETTINGS\LG_PC\DESKTOP\SPARK_LCD\RTC_EEPROM\12F683_SAAT_ISI_2.PBP	00427	         BOS=((sn>>4) & $0F)*10+(SN & $0F):sn=BOS
	MOVE?BB	_bos, _sn

; C:\DOCUMENTS AND SETTINGS\LG_PC\DESKTOP\SPARK_LCD\RTC_EEPROM\12F683_SAAT_ISI_2.PBP	00428	         BOS=((DAK>>4) & $0F)*10+(DAK & $0F):DAK=BOS
	SHIFTR?BCW	_dak, 004h, T1
	AND?WCW	T1, 00Fh, T1
	MUL?WCW	T1, 00Ah, T1
	AND?BCW	_dak, 00Fh, T2
	ADD?WWB	T1, T2, _bos

; C:\DOCUMENTS AND SETTINGS\LG_PC\DESKTOP\SPARK_LCD\RTC_EEPROM\12F683_SAAT_ISI_2.PBP	00428	         BOS=((DAK>>4) & $0F)*10+(DAK & $0F):DAK=BOS
	MOVE?BB	_bos, _dak

; C:\DOCUMENTS AND SETTINGS\LG_PC\DESKTOP\SPARK_LCD\RTC_EEPROM\12F683_SAAT_ISI_2.PBP	00429	         BOS=((SAAT>>4) & $0F)*10+(Saat & $0F):SAAT=BOS
	SHIFTR?BCW	_saat, 004h, T1
	AND?WCW	T1, 00Fh, T1
	MUL?WCW	T1, 00Ah, T1
	AND?BCW	_saat, 00Fh, T2
	ADD?WWB	T1, T2, _bos

; C:\DOCUMENTS AND SETTINGS\LG_PC\DESKTOP\SPARK_LCD\RTC_EEPROM\12F683_SAAT_ISI_2.PBP	00429	         BOS=((SAAT>>4) & $0F)*10+(Saat & $0F):SAAT=BOS
	MOVE?BB	_bos, _saat

; C:\DOCUMENTS AND SETTINGS\LG_PC\DESKTOP\SPARK_LCD\RTC_EEPROM\12F683_SAAT_ISI_2.PBP	00430	         BOS=((GUN>>4) & $0F)*10+(GUN & $0F):GUN=BOS
	SHIFTR?BCW	_GUN, 004h, T1
	AND?WCW	T1, 00Fh, T1
	MUL?WCW	T1, 00Ah, T1
	AND?BCW	_GUN, 00Fh, T2
	ADD?WWB	T1, T2, _bos

; C:\DOCUMENTS AND SETTINGS\LG_PC\DESKTOP\SPARK_LCD\RTC_EEPROM\12F683_SAAT_ISI_2.PBP	00430	         BOS=((GUN>>4) & $0F)*10+(GUN & $0F):GUN=BOS
	MOVE?BB	_bos, _GUN

; C:\DOCUMENTS AND SETTINGS\LG_PC\DESKTOP\SPARK_LCD\RTC_EEPROM\12F683_SAAT_ISI_2.PBP	00431	         BOS=((AY>>4) & $0F)*10+(AY & $0F)  :AY=BOS
	SHIFTR?BCW	_AY, 004h, T1
	AND?WCW	T1, 00Fh, T1
	MUL?WCW	T1, 00Ah, T1
	AND?BCW	_AY, 00Fh, T2
	ADD?WWB	T1, T2, _bos

; C:\DOCUMENTS AND SETTINGS\LG_PC\DESKTOP\SPARK_LCD\RTC_EEPROM\12F683_SAAT_ISI_2.PBP	00431	         BOS=((AY>>4) & $0F)*10+(AY & $0F)  :AY=BOS
	MOVE?BB	_bos, _AY

; C:\DOCUMENTS AND SETTINGS\LG_PC\DESKTOP\SPARK_LCD\RTC_EEPROM\12F683_SAAT_ISI_2.PBP	00432	         BOS=((YIL>>4) & $0F)*10+(YIL & $0F):YIL=BOS
	SHIFTR?BCW	_YIL, 004h, T1
	AND?WCW	T1, 00Fh, T1
	MUL?WCW	T1, 00Ah, T1
	AND?BCW	_YIL, 00Fh, T2
	ADD?WWB	T1, T2, _bos

; C:\DOCUMENTS AND SETTINGS\LG_PC\DESKTOP\SPARK_LCD\RTC_EEPROM\12F683_SAAT_ISI_2.PBP	00432	         BOS=((YIL>>4) & $0F)*10+(YIL & $0F):YIL=BOS
	MOVE?BB	_bos, _YIL

; C:\DOCUMENTS AND SETTINGS\LG_PC\DESKTOP\SPARK_LCD\RTC_EEPROM\12F683_SAAT_ISI_2.PBP	00445	SEROUT2 GPIO.5,84,["LCDWR 1,1-","Hour:"," ",DEC2 saat,":",DEC2 dak,":",DEC2 sn ]
	SEROUT2DPIN?T	_GPIO??5
	SEROUT2MODE?C	054h
	SEROUT2PACE?C	000h
	SEROUT2?C	04Ch
	SEROUT2?C	043h
	SEROUT2?C	044h
	SEROUT2?C	057h
	SEROUT2?C	052h
	SEROUT2?C	020h
	SEROUT2?C	031h
	SEROUT2?C	02Ch
	SEROUT2?C	031h
	SEROUT2?C	02Dh
	SEROUT2?C	048h
	SEROUT2?C	06Fh
	SEROUT2?C	075h
	SEROUT2?C	072h
	SEROUT2?C	03Ah
	SEROUT2?C	020h
	SEROUT2COUNT?C	002h
	SEROUT2NUM?B	_saat
	SEROUT2DEC?	
	SEROUT2?C	03Ah
	SEROUT2COUNT?C	002h
	SEROUT2NUM?B	_dak
	SEROUT2DEC?	
	SEROUT2?C	03Ah
	SEROUT2COUNT?C	002h
	SEROUT2NUM?B	_sn
	SEROUT2DEC?	

; C:\DOCUMENTS AND SETTINGS\LG_PC\DESKTOP\SPARK_LCD\RTC_EEPROM\12F683_SAAT_ISI_2.PBP	00447	PAUSE 25
	PAUSE?C	019h

; C:\DOCUMENTS AND SETTINGS\LG_PC\DESKTOP\SPARK_LCD\RTC_EEPROM\12F683_SAAT_ISI_2.PBP	00448	datesay=datesay+1:if datesay>5 then 
	ADD?BCB	_datesay, 001h, _datesay

; C:\DOCUMENTS AND SETTINGS\LG_PC\DESKTOP\SPARK_LCD\RTC_EEPROM\12F683_SAAT_ISI_2.PBP	00448	datesay=datesay+1:if datesay>5 then 
	CMPLE?BCL	_datesay, 005h, L00104

; C:\DOCUMENTS AND SETTINGS\LG_PC\DESKTOP\SPARK_LCD\RTC_EEPROM\12F683_SAAT_ISI_2.PBP	00449	datesay=0
	MOVE?CB	000h, _datesay

; C:\DOCUMENTS AND SETTINGS\LG_PC\DESKTOP\SPARK_LCD\RTC_EEPROM\12F683_SAAT_ISI_2.PBP	00451	SEROUT2 GPIO.5,84,["LCDWR 2,1-","Date:"," ",DEC2 gun,".",DEC2 ay,".20",DEC2 YIL ]
	SEROUT2DPIN?T	_GPIO??5
	SEROUT2MODE?C	054h
	SEROUT2PACE?C	000h
	SEROUT2?C	04Ch
	SEROUT2?C	043h
	SEROUT2?C	044h
	SEROUT2?C	057h
	SEROUT2?C	052h
	SEROUT2?C	020h
	SEROUT2?C	032h
	SEROUT2?C	02Ch
	SEROUT2?C	031h
	SEROUT2?C	02Dh
	SEROUT2?C	044h
	SEROUT2?C	061h
	SEROUT2?C	074h
	SEROUT2?C	065h
	SEROUT2?C	03Ah
	SEROUT2?C	020h
	SEROUT2COUNT?C	002h
	SEROUT2NUM?B	_GUN
	SEROUT2DEC?	
	SEROUT2?C	02Eh
	SEROUT2COUNT?C	002h
	SEROUT2NUM?B	_AY
	SEROUT2DEC?	
	SEROUT2?C	02Eh
	SEROUT2?C	032h
	SEROUT2?C	030h
	SEROUT2COUNT?C	002h
	SEROUT2NUM?B	_YIL
	SEROUT2DEC?	

; C:\DOCUMENTS AND SETTINGS\LG_PC\DESKTOP\SPARK_LCD\RTC_EEPROM\12F683_SAAT_ISI_2.PBP	00453	PAUSE 25
	PAUSE?C	019h

; C:\DOCUMENTS AND SETTINGS\LG_PC\DESKTOP\SPARK_LCD\RTC_EEPROM\12F683_SAAT_ISI_2.PBP	00454	endif
	LABEL?L	L00104	

; C:\DOCUMENTS AND SETTINGS\LG_PC\DESKTOP\SPARK_LCD\RTC_EEPROM\12F683_SAAT_ISI_2.PBP	00455	  RETURN
	RETURN?	

; C:\DOCUMENTS AND SETTINGS\LG_PC\DESKTOP\SPARK_LCD\RTC_EEPROM\12F683_SAAT_ISI_2.PBP	00457	ZAMAN_YAZ:

	LABEL?L	_zaman_yaz	

; C:\DOCUMENTS AND SETTINGS\LG_PC\DESKTOP\SPARK_LCD\RTC_EEPROM\12F683_SAAT_ISI_2.PBP	00458	hesap=YIL/4
	DIV?BCB	_YIL, 004h, _hesap

; C:\DOCUMENTS AND SETTINGS\LG_PC\DESKTOP\SPARK_LCD\RTC_EEPROM\12F683_SAAT_ISI_2.PBP	00459	k=status.0
	MOVE?TB	_STATUS??0, _k

; C:\DOCUMENTS AND SETTINGS\LG_PC\DESKTOP\SPARK_LCD\RTC_EEPROM\12F683_SAAT_ISI_2.PBP	00460	if k=1 AND AY=2 AND GUN>28 then
	CMPEQ?BCB	_k, 001h, T1
	CMPEQ?BCB	_AY, 002h, T2
	LAND?BBW	T1, T2, T2
	CMPGT?BCB	_GUN, 01Ch, T3
	LAND?WBW	T2, T3, T3
	CMPF?WL	T3, L00106

; C:\DOCUMENTS AND SETTINGS\LG_PC\DESKTOP\SPARK_LCD\RTC_EEPROM\12F683_SAAT_ISI_2.PBP	00461	GUN=28
	MOVE?CB	01Ch, _GUN

; C:\DOCUMENTS AND SETTINGS\LG_PC\DESKTOP\SPARK_LCD\RTC_EEPROM\12F683_SAAT_ISI_2.PBP	00462	ELSE
	GOTO?L	L00107
	LABEL?L	L00106	

; C:\DOCUMENTS AND SETTINGS\LG_PC\DESKTOP\SPARK_LCD\RTC_EEPROM\12F683_SAAT_ISI_2.PBP	00464	 if k=0 and ay=2 and gun>28 then 
	CMPEQ?BCB	_k, 000h, T1
	CMPEQ?BCB	_AY, 002h, T2
	LAND?BBW	T1, T2, T2
	CMPGT?BCB	_GUN, 01Ch, T3
	LAND?WBW	T2, T3, T3
	CMPF?WL	T3, L00108

; C:\DOCUMENTS AND SETTINGS\LG_PC\DESKTOP\SPARK_LCD\RTC_EEPROM\12F683_SAAT_ISI_2.PBP	00465	    gun=29
	MOVE?CB	01Dh, _GUN

; C:\DOCUMENTS AND SETTINGS\LG_PC\DESKTOP\SPARK_LCD\RTC_EEPROM\12F683_SAAT_ISI_2.PBP	00466	    else
	GOTO?L	L00109
	LABEL?L	L00108	

; C:\DOCUMENTS AND SETTINGS\LG_PC\DESKTOP\SPARK_LCD\RTC_EEPROM\12F683_SAAT_ISI_2.PBP	00467	    endif
	LABEL?L	L00109	

; C:\DOCUMENTS AND SETTINGS\LG_PC\DESKTOP\SPARK_LCD\RTC_EEPROM\12F683_SAAT_ISI_2.PBP	00468	endif
	LABEL?L	L00107	

; C:\DOCUMENTS AND SETTINGS\LG_PC\DESKTOP\SPARK_LCD\RTC_EEPROM\12F683_SAAT_ISI_2.PBP	00470	        TEMP=(SN DIG 1)<<4+SN DIG 0:SN=TEMP
	DIG?BCW	_sn, 001h, T1
	SHIFTL?WCW	T1, 004h, T1
	DIG?BCW	_sn, 000h, T2
	ADD?WWB	T1, T2, _TEMP

; C:\DOCUMENTS AND SETTINGS\LG_PC\DESKTOP\SPARK_LCD\RTC_EEPROM\12F683_SAAT_ISI_2.PBP	00470	        TEMP=(SN DIG 1)<<4+SN DIG 0:SN=TEMP
	MOVE?BB	_TEMP, _sn

; C:\DOCUMENTS AND SETTINGS\LG_PC\DESKTOP\SPARK_LCD\RTC_EEPROM\12F683_SAAT_ISI_2.PBP	00471	        TEMP=(DAK DIG 1)<<4+DAK DIG 0:DAK=TEMP
	DIG?BCW	_dak, 001h, T1
	SHIFTL?WCW	T1, 004h, T1
	DIG?BCW	_dak, 000h, T2
	ADD?WWB	T1, T2, _TEMP

; C:\DOCUMENTS AND SETTINGS\LG_PC\DESKTOP\SPARK_LCD\RTC_EEPROM\12F683_SAAT_ISI_2.PBP	00471	        TEMP=(DAK DIG 1)<<4+DAK DIG 0:DAK=TEMP
	MOVE?BB	_TEMP, _dak

; C:\DOCUMENTS AND SETTINGS\LG_PC\DESKTOP\SPARK_LCD\RTC_EEPROM\12F683_SAAT_ISI_2.PBP	00472	        TEMP=(SAAT DIG 1)<<4+SAAT DIG 0:SAAT=TEMP
	DIG?BCW	_saat, 001h, T1
	SHIFTL?WCW	T1, 004h, T1
	DIG?BCW	_saat, 000h, T2
	ADD?WWB	T1, T2, _TEMP

; C:\DOCUMENTS AND SETTINGS\LG_PC\DESKTOP\SPARK_LCD\RTC_EEPROM\12F683_SAAT_ISI_2.PBP	00472	        TEMP=(SAAT DIG 1)<<4+SAAT DIG 0:SAAT=TEMP
	MOVE?BB	_TEMP, _saat

; C:\DOCUMENTS AND SETTINGS\LG_PC\DESKTOP\SPARK_LCD\RTC_EEPROM\12F683_SAAT_ISI_2.PBP	00473	        TEMP=(GUN DIG 1)<<4+GUN DIG 0:GUN=TEMP
	DIG?BCW	_GUN, 001h, T1
	SHIFTL?WCW	T1, 004h, T1
	DIG?BCW	_GUN, 000h, T2
	ADD?WWB	T1, T2, _TEMP

; C:\DOCUMENTS AND SETTINGS\LG_PC\DESKTOP\SPARK_LCD\RTC_EEPROM\12F683_SAAT_ISI_2.PBP	00473	        TEMP=(GUN DIG 1)<<4+GUN DIG 0:GUN=TEMP
	MOVE?BB	_TEMP, _GUN

; C:\DOCUMENTS AND SETTINGS\LG_PC\DESKTOP\SPARK_LCD\RTC_EEPROM\12F683_SAAT_ISI_2.PBP	00474	        TEMP=(AY DIG 1)<<4+AY DIG 0:AY=TEMP
	DIG?BCW	_AY, 001h, T1
	SHIFTL?WCW	T1, 004h, T1
	DIG?BCW	_AY, 000h, T2
	ADD?WWB	T1, T2, _TEMP

; C:\DOCUMENTS AND SETTINGS\LG_PC\DESKTOP\SPARK_LCD\RTC_EEPROM\12F683_SAAT_ISI_2.PBP	00474	        TEMP=(AY DIG 1)<<4+AY DIG 0:AY=TEMP
	MOVE?BB	_TEMP, _AY

; C:\DOCUMENTS AND SETTINGS\LG_PC\DESKTOP\SPARK_LCD\RTC_EEPROM\12F683_SAAT_ISI_2.PBP	00475	        TEMP=(YIL DIG 1)<<4+YIL DIG 0:YIL=TEMP
	DIG?BCW	_YIL, 001h, T1
	SHIFTL?WCW	T1, 004h, T1
	DIG?BCW	_YIL, 000h, T2
	ADD?WWB	T1, T2, _TEMP

; C:\DOCUMENTS AND SETTINGS\LG_PC\DESKTOP\SPARK_LCD\RTC_EEPROM\12F683_SAAT_ISI_2.PBP	00475	        TEMP=(YIL DIG 1)<<4+YIL DIG 0:YIL=TEMP
	MOVE?BB	_TEMP, _YIL

; C:\DOCUMENTS AND SETTINGS\LG_PC\DESKTOP\SPARK_LCD\RTC_EEPROM\12F683_SAAT_ISI_2.PBP	00477	        I2CWrite SDA, SCL,$D1,$00,[SN,DAK,SAAT,HAFGUN,GUN,AY,YIL]
	I2CDATA?T	_SDA
	I2CCLOCK?T	_SCL
	I2CWRITE?C	0D1h
	I2CWRITE?C	000h
	I2CWRITE?B	_sn
	I2CWRITE?B	_dak
	I2CWRITE?B	_saat
	I2CWRITE?B	_HAFGUN
	I2CWRITE?B	_GUN
	I2CWRITE?B	_AY
	I2CWRITES?B	_YIL

; C:\DOCUMENTS AND SETTINGS\LG_PC\DESKTOP\SPARK_LCD\RTC_EEPROM\12F683_SAAT_ISI_2.PBP	00478	        PAUSE 10 
	PAUSE?C	00Ah

; C:\DOCUMENTS AND SETTINGS\LG_PC\DESKTOP\SPARK_LCD\RTC_EEPROM\12F683_SAAT_ISI_2.PBP	00480	        return 
	RETURN?	

	END
